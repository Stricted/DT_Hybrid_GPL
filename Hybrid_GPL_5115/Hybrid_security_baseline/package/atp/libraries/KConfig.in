## Hybrid_GPL_5115/Hybrid_security_baseline/product/version/Config.in
```kconfig
menu "Product Version config"
	
choice
	prompt "Release Image Build Edit"
	
config BUILD_ATP_RELEASE_IAMGE
	bool "build releader image"
	depends on !BUILD_FMC_DEBUG_VERSION
	help
	build release image 
	
config BUILD_ATP_DEBUG_IAMGE
	bool "build debug image"
	depends on BUILD_FMC_DEBUG_VERSION
	help
	build debug image 
	
config BUILD_ATP_ACS_IAMGE
	bool "build acs image"
	depends on !BUILD_FMC_DEBUG_VERSION
	help
	build acs image 
	
endchoice
	

config HGW_PRODUCTTYPE
	string "HGW_PRODUCTTYPE"
	default "HGW"

config HGW_PRODUCTNAME
	string "HGW_PRODUCTNAME"
	default "ATP"
	
config HGW_PRODUCTCLASS
	string "HGW_PRODUCTCLASS"
	default "ATP"
	
config HGW_SOFTVERSION
	string "HGW_SOFTVERSION"
	default "V100R005C01B002"
	
config HGW_BATCHNUMBER
	string "HGW_BATCHNUMBER"
	default "ATPV100R005C01B002"
	
config HGW_RELEASE
	string "HGW_RELEASE"
	default "ATPV100R005C01B002"

config HGW_RELEASE_CUSTOMER
	string "HGW_RELEASE_CUSTOMER"
	default "ATPV100R005C01B002"
	
config HGW_RELEASE_ENGINEERING
	string "HGW_RELEASE_ENGINEERING"
	default "ATPV100R005C01B002"
	
config HGW_RELEASE_ACS
	string "HGW_RELEASE_ACS"
	default "ATPV100R005C01B002"
	
config HGW_SOFTVERSION_WEB
	string
	default $(HGW_RELEASE_CUSTOMER) if BUILD_ATP_RELEASE_IAMGE
	default $(HGW_RELEASE_ENGINEERING) if BUILD_ATP_DEBUG_IAMGE
	default $(HGW_RELEASE_ACS) if BUILD_ATP_ACS_IAMGE
	help
	  This is the softversion show on the web page.	
	
config PCB_VERSION
	string "PCB_VERSION"
	default "PCB 1.0"
	help
		HUAWEI HARDWARE VERSION
endmenu
```

## Hybrid_GPL_63168/DT-W724V-20140311/boot/Config.in
```kconfig
config BUILD_BOOTLOADER
	bool "support bootloader"
if BUILD_BOOTLOADER
menu "Bootloaders"
config BUILD_BOOTLOADER_SHA256
	bool "Support SHA2"
	default n
config BUILD_BOOTLOADER_SHA512
	bool "Support SHA4"
	default n

config ATP_WRITE_FLASH_LIGHTING_FREQUENCY
	int "atp write flash led lighting frequency"
	default 20
	help 
		this is not the really frequency,it depends the flash,you can use this to adjust the frequency.
		
config ATP_ERASE_FLASH_LIGHTING_FREQUENCY
	int "atp erase flash led lighting frequency"
	default 20
	help 
		this is not the really frequency,it depends the flash,you can use this to adjust the frequency.
		
config ATP_MULTI_DOWNLOADE_IMAGE_LIGHTING_FREQUENCY
	int "atp multi download led lighting frequency"
	default 10
	help 
		this is not the really frequency,it depends the flash,you can use this to adjust the frequency.
		
config ATP_WRITE_FLASH_LIGHTING_LED_NUM
	int "atp write flash lighting led num"
	default 20
	help 
		this num can't bigger than 20.
		
config ATP_MULTI_UPG_LAST_LIGHTING_LED_NUM
	int "atp mutil upg last lighting led num"
	default 20
	help 
		this num can't bigger than 20.
		
config ATP_MULTI_DOWNLOADE_IMAGE_LIGHTING_LED_NUM
	int "atp multi downloade image lighting led num"
	default 20
	help 
		this num can't bigger than 20.
		
config BL_POWER_LED_ON
	bool "Support bootloader power LED on"
	default n
	help
		Enable this option if you need to set power led on in bootloader.
		
config SUPPORT_BOOT_FAIL_LIGHTING
	bool "Support boot fail lighting"
	default n
	help
		Support boot fail lighting.

if SUPPORT_BOOT_FAIL_LIGHTING
menu "BOOT FAIL LIGHTING"
config ATP_BOOT_FAIL_LIGHTING_LED_NUM
	int "atp boot fail lighting led num"
	default 20
	help 
		this num can't bigger than 20.
		
config ATP_BOOTFAIL_LIGHTING_FREQUENCY
	int "atp boot fail lighting frequency"
	default 10
	help 
		this is not the really frequency,it depends the flash,you can use this to adjust the frequency.
endmenu
endif		
		
source "boot/bootloadercmd/Config.in"	
source "boot/broadcom/Config.in"
source "boot/qualcomm/Config.in"
source "boot/mtk/Config.in"
source "boot/realtek/Config.in"
source "boot/hisi/Config.in"
source "boot/barebox/Config.in"
source "boot/grub/Config.in"
source "boot/syslinux/Config.in"
source "boot/uboot/Config.in"
source "boot/at91bootstrap/Config.in"
source "boot/at91dataflashboot/Config.in"
source "boot/xloader/Config.in"
endmenu
endif
```

## Hybrid_GPL_63168/DT-W724V-20140311/boot/broadcom/Config.in
```kconfig
config BROADCOM_BOOT
	bool "support broadcom boot"

if BROADCOM_BOOT
config BOOTLOADER_VENDOR
	string 
	default "BROADCOM"
	
choice
	prompt "broadcom boot edition"
	
config BROADCOM_BOOT_1_000
	bool "broadcom boot 1.000"

endchoice

config BROADCOM_BOOT_DEFAULT_BOOTLINE
	string "set broadcom default bootline"
	default "e=192.168.1.1:ffffff00 h=192.168.1.100 g= r=f f=vmlinux i=bcm963xx_fs_kernel d=1 p=0 "

endif
```

## Hybrid_GPL_63168/DT-W724V-20140311/boot/hisi/Config.in
```kconfig
config BUILD_HISI_BOOT
	bool "Support HISI Boot"
	
config BOOTLOADER_VENDOR
	string 
	default "HISILICON"
	depends on BUILD_HISI_BOOT
```
