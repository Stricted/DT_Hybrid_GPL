## Hybrid_GPL_5115/Hybrid_security_baseline/package/atp/libraries/KConfig.in
```kconfig
menu "Libraries Linux Kernel Extension"
source "package/atp/libraries/opensrc/ebtables/KConfig.in"
endmenu
```

## Hybrid_GPL_5115/Hybrid_security_baseline/package/atp/libraries/opensrc/busybox/Config.in
```kconfig
config BUILD_BUSYBOX
	bool "ATP BUSYBOX"
	select BUILD_LIBZ
	select BUILD_SSL
	default y
	help
	  POSIX Access Control Lists, which are used to define more
	  fine-grained discretionary access rights for files and
	  directories.
	  This package also provides libacl.
	  
if BUILD_BUSYBOX
menu "ATP BUSYBOX Supported Selection"

# ATP all applications
config BUILD_BUSYBOX_ATP_FTP
	bool "Support ATP FTP"
	default n

config BUILD_BUSYBOX_ATP_FTP_ZIP
	bool "Support ATP FTP ZIP"
	default n
	depends on BUILD_BUSYBOX_ATP_FTP

config BUILD_BUSYBOX_TFTP
	bool "Support TFTP Client"
	default n

config BUILD_BUSYBOX_ATP_TFTPD
	bool "Support ATP TFTP SERVER"
	default y
	
config BUILD_BUSYBOX_ATP_WGET
	bool "Support ATP WGET"
	default n

config BUILD_BUSYBOX_ATP_WGET_HTTPS
	bool "Support ATP WGET HTTPS"
	default n
	depends on BUILD_BUSYBOX_ATP_WGET
	
config BUILD_BUSYBOX_ATP_WGET_ZIP
	bool "Support ATP WGET ZIP"
	default n
	depends on BUILD_BUSYBOX_ATP_WGET

config BUILD_BUSYBOX_ATP_WGET_PUT
	bool "Support put method,select it will not support post method"
	default n
	depends on BUILD_BUSYBOX_ATP_WGET
	
config BUILD_BUSYBOX_MV
	bool "Support MV"
	default n
	
config BUILD_BUSYBOX_FEATURE_IPV6
	bool "Support Feature IPV6"
	default y 
	depends on BUILD_IPV6

config BUILD_BUSYBOX_ATP_PING6
	bool "Support ATP Ping6"
	default y
	depends on BUILD_IPV6
	
config BUILD_BUSYBOX_ATP_IFENSLAVE
	bool "Support ATP ifenslave"
	default n

config BUILD_BUSYBOX_ATP_TRACEROUTE6
	bool "Support ATP TraceRoute6"
	default y
	depends on BUILD_IPV6
	
config BUILD_BUSYBOX_SLEEP
	bool "Support sleep"
	default n

config BUILD_BUSYBOX_SU
	bool "Support SU"
	default n

config BUILD_BUSYBOX_CROND
	bool "Support CROND"
	default n
	
config BUILD_BUSYBOX_CRONTAB
	bool "Support CRONTAB"
	default n
	depends on BUILD_BUSYBOX_CROND
	
config BUILD_BUSYBOX_DIFF
	bool "Support DIFF"
	default n	

config BUILD_BUSYBOX_SED
	bool "Support SED"
	default n

config BUILD_BUSYBOX_AWK
	bool "Support AWK"
	default n

config BUILD_BUSYBOX_START_STOP_DAEMON
	bool "Support Start-stop-daemon"
	default n

config BUILD_BUSYBOX_START_STOP_DAEMON_FANCY
	bool "Support Start-stop-daemon Fancy"
	default n
	depends on BUILD_BUSYBOX_START_STOP_DAEMON

config BUILD_BUSYBOX_START_STOP_DAEMON_LONG_OPTIONS
	bool "Support Start-stop-daemon Long Options"
	default n
	depends on BUILD_BUSYBOX_START_STOP_DAEMON
	depends on BUILD_BUSYBOX_GETOPT_LONG
	
config BUILD_BUSYBOX_GETOPT_LONG
	bool "Support Long Options"
	default n

config BUILD_BUSYBOX_TRUE
	bool "Support TRUE"
	default n

config BUILD_BUSYBOX_CUT
	bool "Support CUT"
	default n

config BUILD_BUSYBOX_GREP
	bool "Support Grep"
	default n

config BUILD_BUSYBOX_CHOWN
	bool "Support CHOWN"
	default n

config BUILD_BUSYBOX_RMMOD
	bool "Support RMMOD"
	default n

config BUILD_BUSYBOX_LN
	bool "Support LN"
	default n
	
config BUILD_BUSYBOX_SETCONSOLE
	bool "Support Setconsole"
	default n

config BUILD_BUSYBOX_USLEEP
	bool "Support usleep"
	default n
	
config BUILD_BUSYBOX_ARPING
	bool "Support Arping"
	default n

config BUILD_BUSYBOX_TAR
	bool "Support tar"
	default n
	
endmenu
endif
```

## Hybrid_GPL_5115/Hybrid_security_baseline/package/atp/libraries/opensrc/ebtables/Config.in
```kconfig
config BUILD_EBTABLES
	bool "ebtables"
	depends on BUILD_LINUX
	default y
	help
	  Support ebtables.

if BUILD_EBTABLES
config ATP_EBTABLES_VERSION
       string
	   default "2.0.6" if BR2_LINUX_KERNEL_VERSION = "2.6.30"
	   default "2.0.6" if BR2_LINUX_KERNEL_VERSION = "2.6.21.5"
	   help
	     iptables' version
endif
```

## Hybrid_GPL_5115/Hybrid_security_baseline/package/atp/libraries/opensrc/ebtables/KConfig.in
```kconfig
config BRIDGE_EBT_QINQ
	bool "ebtables support qinq"
	default y

config BRIDGE_EBT_IP_IPRANGE
	bool "Extent the ebtables function for IP range."
	default y
	
	
```

## Hybrid_GPL_5115/Hybrid_security_baseline/package/atp/libraries/opensrc/gplutil/Config.in
```kconfig
config BUILD_GPLUTIL
	bool "ATP gplutil"
	help
	  POSIX Access Control Lists, which are used to define more
	  fine-grained discretionary access rights for files and
	  directories.
	  This package also provides libacl.
```

## Hybrid_GPL_5115/Hybrid_security_baseline/package/atp/libraries/opensrc/iptables/Config.in
```kconfig
config BUILD_IPTABLES
	bool "iptables"
	depends on BUILD_LINUX
	default y
	help
	  Support iptables.

if BUILD_IPTABLES
config ATP_IPTABLES_VERSION
       string
	   default "1.4.16.3" if BR2_LINUX_KERNEL_VERSION = "2.6.30"
	   default "1.4.0.1" if BR2_LINUX_KERNEL_VERSION = "2.6.21.5"
	   help
	     iptables' version
endif
```

## Hybrid_GPL_5115/Hybrid_security_baseline/package/atp/libraries/opensrc/libiconv/Config.in
```kconfig
config BUILD_LIBICONV
    bool "Support libiconv"
    default n
    help
      For charset translate.
```

## Hybrid_GPL_5115/Hybrid_security_baseline/package/atp/libraries/opensrc/libpcap/Config.in
```kconfig
config BUILD_LIBPCAP
    bool "Support libpcap"
    default n
    help
      For network traffic capture.
```

## Hybrid_GPL_5115/Hybrid_security_baseline/package/atp/libraries/opensrc/libz/Config.in
```kconfig
config BUILD_LIBZ
	bool "ATP libz"
	help
	  POSIX Access Control Lists, which are used to define more
	  fine-grained discretionary access rights for files and
	  directories.
	  This package also provides libacl.	  
```

## Hybrid_GPL_5115/Hybrid_security_baseline/package/atp/libraries/private/bhalapi/Config.in
```kconfig
menu "ATP BHAL"
source "package/atp/libraries/private/bhalapi/KeyConfig.in"

config DT_MAC_SUPPORT
	bool "DT_MAC_SUPPORT"
	default n
	help
	  Support datacard service.

if 	DT_MAC_SUPPORT

choice
	prompt "Choose DT Custom Product"
	default DT_W724V_MAC_SUPPORT
	
config DT_W724V_MAC_SUPPORT
	bool "support W724v MAC distribute"	
	help
	  Enable this option if your custom DT product is W724v	

config DT_W723V_MAC_SUPPORT
	bool "support W723v MAC distribute"	
	help
	  Enable this option if your custom DT product is W723v	

endchoice 

endif	##end of GPIO_CTRL_BCM4360_RF	
endmenu	
```

## Hybrid_GPL_5115/Hybrid_security_baseline/package/atp/libraries/private/bhalapi/KConfig.in
```kconfig
config SUPPORT_ATP
	bool "Support ATP feature"
	default y
	
config ATP_SUPPORT_DOUBLE_SYSTEM
	bool "Sure to support double system "
	default y
	
config ATP_USB_ADAPTOR
	bool "atp usb adaptor"
	default n
	
config INTERNET_LED_SINGTEL
	bool "Internet Led"
	default n 
	depends on BCM96362	
		
config BCM96362_DAYINGGASP
	bool "Implementation daying gasp"
    depends on BCM96362
	default n
	help	
	  This options enables the support of dayinggasp	
	
config ATP_SUPPORT_ETHERNETLED
	bool "Ethernet Led"
	default n 
	depends on BCM963268	
```

## Hybrid_GPL_5115/Hybrid_security_baseline/package/atp/network/KConfig.in
```kconfig
menu "Network Linux Kernel Extension"
source "package/atp/network/igmp/KConfig.in"
source "package/atp/network/mld/KConfig.in"
source "package/atp/network/firewall/KConfig.in"
config PORT_SCAN
	bool "port scan"
	default y
config ATP_DROP_ARP
	bool "drop the arp packages"
	default y
	help
		 the arp package is from wan to lan, br to wan.
config RESERVE_CT_SESSION
	bool "Reserve some session for certain bussiness"
	default n
config IP_NF_TARGET_PORT_TRIGGERING
	bool "Sure to support port_trigger"
	default n 
	depends on BCM963268
endmenu
```

## Hybrid_GPL_5115/Hybrid_security_baseline/package/atp/network/common/Config.in
```kconfig
menu "common module"
source "package/atp/network/common/ipv6common/Config.in"
endmenu
```

## Hybrid_GPL_5115/Hybrid_security_baseline/package/atp/network/igmp/KConfig.in
```kconfig
config IGMP
	tristate "IGMP"
	default y
config IGMP_SNOOPING
	tristate "IGMP Snooping"
	default y
	depends on IGMP
config BR_IGMP_STATISTIC
	bool "IGMP support statistic"
	default n	
	depends on IGMP
config IGMP_ENG_DT
	bool "IGMP support DT ENG STAT"
	default n	
	depends on IGMP
config IGMP_MAX_MSF
    int "IGMP max source for v3"
    help
      igmp max source number
    default 10
    depends on IGMP
config IGMP_MAX_GROUP_NUMBER
    int "IGMP max groups number"
    help
      igmp max groups number
    default 32
    depends on IGMP
```

## Hybrid_GPL_5115/Hybrid_security_baseline/package/atp/network/mld/Config.in
```kconfig
config BUILD_MLD
	bool "MLD"
 	default y
	help
	  Multicast Listener Discovery
	depends on BUILD_IPV6  

if BUILD_MLD
menu "ATP MLD Supported Selection"

choice
	prompt "Choose MLD SNOOPING solution"
	default BUILD_MLD_SNOOPING
	depends on BUILD_MLD
	
	config BUILD_BR_MLD_SNOOP
        bool "BROADCOM MLD snoop"

	config BUILD_MLD_SNOOPING
        bool "ATP MLD snooping"

endchoice

endmenu
endif
```

## Hybrid_GPL_5115/Hybrid_security_baseline/package/atp/network/mld/KConfig.in
```kconfig
config MLD
	tristate "MLD"
	default y
config MLD_SNOOPING
	tristate "MLD Snooping"
	default y
	depends on MLD
```

## Hybrid_GPL_5115/Hybrid_security_baseline/product/Config.in
```kconfig
menu "Product Config"

menu "Product Info" 
config BUILD_PRODUCT_NAME
	string "Product full name"
	default "HG2XX"
	help
	  Config custom product full name

config CONFIG_B880_PRODUCT
	bool "b880 product"
	select BUILD_USBOM if BUILD_FMC_DEBUG_VERSION

#/* <DTS2013092310511 z00182709 2013/09/24 begin */
config CONFIG_B881_PRODUCT
	bool "b881 product"
	select BUILD_USBOM if BUILD_FMC_DEBUG_VERSION
#/* DTS2013092310511 z00182709 2013/09/24 end> */
	
config BOARD_ID
	string  "Set Board Id"
	help
	  Set Board Id
	  eg:963268_hg257
		 963268_hg2xx
		 
config VOICE_BOARD_ID
	string  "Set Voice Board Id"
	help
	  Set Voice Board Id
	  eg:LE88536_THAL
		 LE9530_LE88276
endmenu		 
	 
source "product/version/Config.in"
source "product/flash/Config.in"
source "product/gpio/Config.in"
source "product/startup/Config.in"
source "product/image/Config.in"
source "product/feature/Config.in"

endmenu 
```

## Hybrid_GPL_5115/Hybrid_security_baseline/product/feature/Config.in
```kconfig
menu "Product Feature config"
		
config BUILD_NAMEFROMAMSS
	bool "GET NAME FROM AMSS"
	help
	for get operator name for amss 
	
config BUILD_ATH3G
	bool "ATH3G"
	help
	for AT H3G 

config BUILD_B880_CUBE
    bool "B880 CUBE"
	depends on CONFIG_B880_PRODUCT	
    help
      B190 is B880 CUBE	
		
config BUILD_FORBID_ROAMING
	bool "Disconnect when roaming"
	help
	for limit roaming dial up 		

config BUILD_FMC_DECT
	bool "support dect"
	default n
	
config BUILD_B882
    bool "support B882"
	default n
    help
      B882 is from B890

config BUILD_CHINA_TELECOM
	bool "support China Telecom feature"
	default n
	
endmenu
```

## Hybrid_GPL_5115/Hybrid_security_baseline/product/gpio/Config.in
```kconfig
menu "GPIO Config"

# GPIO applications
source "product/gpio/button/Config.in"
source "product/gpio/led/LedConfig.in"
source "product/gpio/customize/Config.in"

endmenu
```

## Hybrid_GPL_5115/Hybrid_security_baseline/product/image/Config.in
```kconfig
menu "Image Name Config"

config HGW_IMAGE_RELEASE_WITH_BOOTLOADER_NAME
	string "RELEASE IMAGE WITH BOOTLOADER NAME"
	default "$(HGW_PRODUCTNAME)$(HGW_RELEASE_CUSTOMER)_pack"
	help
	  set release image with bootloader name

config HGW_IMAGE_RELEASE_WITHOUT_BOOTLOADER_NAME
	string "RELEASE IMAGE WITHOUT BOOTLOADER NAME"
	default "$(HGW_PRODUCTNAME)$(HGW_RELEASE_CUSTOMER)_main"
	help
	  set release image without bootloader name 
	
config HGW_IMAGE_DEBUG_WITH_BOOTLOADER_NAME
	string "DEBUG IMAGE NAME WITH BOOTLADER"
	default "$(HGW_PRODUCTNAME)$(HGW_RELEASE_ENGINEERING)_pack_debug"
	help
	  set debug image with bootloader name 

config HGW_IMAGE_DEBUG_WITHOUT_BOOTLOADER_NAME
	string "DEBUG IMAGE NAME WITHOUT BOOTLADER"
	default "$(HGW_PRODUCTNAME)$(HGW_RELEASE_ENGINEERING)_main_debug"
	help
	  set debug image without bootloader name 
	
config HGW_IMAGE_ACS_WITH_BOOTLOADER_NAME
	string "ACS IMAGE NAME WITHOUT BOOTLOADER"
	default "$(HGW_PRODUCTNAME)$(HGW_RELEASE_ACS)_pack_acs"
	help
	  set acs image with bootloader name 
	  
config HGW_IMAGE_ACS_WITHOUT_BOOTLOADER_NAME
	string "ACS IMAGE NAME WITHOUTOUT BOOTLOADER"
	default "$(HGW_PRODUCTNAME)$(HGW_RELEASE_ACS)_main_acs"
	help
	  set acs image without bootloader name 
	
config HGW_IMAGE_MULTICAST_UPGRADE_NOT_RESTORE_DEFAULT_WITH_BOOTLOADER_NAME
	string "multicast upgrade image not restore default and with bootloader name"
	default "$(HGW_PRODUCTNAME)$(HGW_RELEASE_CUSTOMER)_multicast_not_restore_default_pack"
	help
	  set multicast upgrade image not restore default and with bootloader name
	  
config HGW_IMAGE_MULTICAST_UPGRADE_NOT_RESTORE_DEFAULT_WITHOUT_BOOTLOADER_NAME
	string "multicast upgrade image not restore default and without bootloader name"
	default "$(HGW_PRODUCTNAME)$(HGW_RELEASE_CUSTOMER)_multicast_not_restore_default_main"
	help
	  set multicast upgrade image not restore default and without bootloader name
	  
config HGW_IMAGE_MULTICAST_UPGRADE_RESTORE_DEFAULT_WITH_BOOTLOADER_NAME
	string "multicast upgrade image restore default and with bootloader name"
	default "$(HGW_PRODUCTNAME)$(HGW_RELEASE_CUSTOMER)_multicast_restore_default_pack"
	help
	  set multicast upgrade image restore default and with bootloader name
	  
config HGW_IMAGE_MULTICAST_UPGRADE_RESTORE_DEFAULT_WITHOUT_BOOTLOADER_NAME
	string "multicast upgrade image restore default and without bootloader name"
	default "$(HGW_PRODUCTNAME)$(HGW_RELEASE_CUSTOMER)_multicast_restore_default_main"
	help
	  set multicast upgrade image restore default and without bootloader name
	  
config HGW_IMAGE_MULTICAST_UPGRADE_USE_MULTI_CFG_WITH_BOOTLOADER_NAME
	string "multicast upgrade image use multi cfg with bootloader name"
	default "$(HGW_PRODUCTNAME)$(HGW_RELEASE_CUSTOMER)_multicast_with_multicfg_pack"
	help
	  set multicast upgrade image use multi cfg with bootloader name
	  
config HGW_IMAGE_MULTICAST_UPGRADE_USE_MULTI_CFG_WITHOUT_BOOTLOADER_NAME
	string "multicast upgrade image use multi cfg without bootloader name"
	default "$(HGW_PRODUCTNAME)$(HGW_RELEASE_CUSTOMER)_multicast_with_multicfg_main"
	help
	  set multicast upgrade image use multi cfg without bootloader name
	
config HGW_IMAGE_FACTORY_NAME
	string "FACTORY IMAGE NAME"
	default "$(HGW_PRODUCTNAME)$(HGW_RELEASE_CUSTOMER)_factory"
	help
	  set factory image name

endmenu

menu "Image Building Config"

menu"Multcast upgrade Image Build Edit"
	
config BUILD_ATP_MULTCAST_NOT_RESTORE_DEFAULT
	bool "build multcast upgrade image not restore default"
	help
	build multcast upgrade image not restore default
	
config BUILD_ATP_MULTCAST_RESTORE_DEFAULT
	bool "build multcast upgrade image retore default"
	help
	build multcast upgrade image retore default
	
config BUILD_ATP_MULTCAST_USE_MULTI_CFG
	bool "build multcast upgrade image use factorycfg"
	help
	build multcast upgrade image use factorycfg
endmenu

menu"Multcast config Image Build Edit"
	
config BUILD_ATP_CONFIG_IAMGE
	bool "build config image"
	help
	build config image 
endmenu

config BUILD_ATP_FACTORY_IMAGE
	bool "build factory image"
	default n
	help
	build factory image

config BUILD_ATP_DECT_INTO_IAMGE
	bool "build dect into image"
	default n
	help
	build dect into image
	
endmenu
```
