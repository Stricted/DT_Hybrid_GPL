## Hybrid_GPL_5115/Hybrid_security_baseline/boot/Config.in
```kconfig
config BUILD_BOOTLOADER
	bool "support bootloader"
if BUILD_BOOTLOADER
menu "Bootloaders"
config BUILD_BOOTLOADER_SHA256
	bool "Support SHA2"
	default n
config BUILD_BOOTLOADER_SHA512
	bool "Support SHA4"
	default n

config ATP_WRITE_FLASH_LIGHTING_FREQUENCY
	int "atp write flash led lighting frequency"
	default 20
	help 
		this is not the really frequency,it depends the flash,you can use this to adjust the frequency.
		
config ATP_ERASE_FLASH_LIGHTING_FREQUENCY
	int "atp erase flash led lighting frequency"
	default 20
	help 
		this is not the really frequency,it depends the flash,you can use this to adjust the frequency.
		
config ATP_MULTI_DOWNLOADE_IMAGE_LIGHTING_FREQUENCY
	int "atp erase flash led lighting frequency"
	default 10
	help 
		this is not the really frequency,it depends the flash,you can use this to adjust the frequency.
		
config ATP_WRITE_FLASH_LIGHTING_LED_NUM
	int "atp write flash lighting led num"
	default 20
	help 
		this num can't bigger than 20.
		
config ATP_MULTI_UPG_LAST_LIGHTING_LED_NUM
	int "atp mutil upg last lighting led num"
	default 20
	help 
		this num can't bigger than 20.
		
config ATP_MULTI_DOWNLOADE_IMAGE_LIGHTING_LED_NUM
	int "atp multi downloade image lighting led num"
	default 20
	help 
		this num can't bigger than 20.
		
source "boot/bootloadercmd/Config.in"	
source "boot/broadcom/Config.in"
source "boot/qualcomm/Config.in"
source "boot/mtk/Config.in"
source "boot/realtek/Config.in"
source "boot/hisi/Config.in"
source "boot/barebox/Config.in"
source "boot/grub/Config.in"
source "boot/syslinux/Config.in"
source "boot/uboot/Config.in"
source "boot/at91bootstrap/Config.in"
source "boot/at91dataflashboot/Config.in"
source "boot/xloader/Config.in"
endmenu
endif
```

## Hybrid_GPL_5115/Hybrid_security_baseline/boot/bootloadercmd/Config.in
```kconfig
config BUILD_BOOTLOADER_CMD
        bool "support bootloader cmd"
 
if BUILD_BOOTLOADER_CMD
		
choice
	prompt "bootloder cmd edition"
	
config BUILD_ATP_BOOTLOADER_NO_CMD
	bool "bootloader with no cmd"
	help
	bootloader with no cmd
	
config BUILD_ATP_BOOTLOADER_NORMAL_CMD
	bool "bootloader with normal cmd"
	help
	bootloader with normal cmd:help,reset,b,r,cg,ccs,gccs,c,p.
	
config BUILD_ATP_BOOTLOADER_ALL_CMD
	bool "bootloader with all cmd"
	help
	bootloader with all cmd:help,reset,b,r,cg,ccs,gccs,c,p,i,e...

endchoice
 
endif
```

## Hybrid_GPL_5115/Hybrid_security_baseline/boot/hisi/Config.in
```kconfig
config BUILD_HISI_BOOT
	bool "Support HISI Boot"

if BUILD_HISI_BOOT
choice
	prompt "Hisi Boot Type"
	default BUILD_HISI_HIBOOT
	help
	  Set the debug level for gcc

config BUILD_HISI_HIBOOT
	bool "Support HISI Hi_Boot"

config BUILD_HISI_UBOOT
	bool "Support HISI U_Boot"

endchoice
endif
	
config BOOTLOADER_VENDOR
	string 
	default "HISILICON"
	depends on BUILD_HISI_BOOT
```

## Hybrid_GPL_5115/Hybrid_security_baseline/boot/qualcomm/Config.in
```kconfig
config QUALCOMM_BOOT
    bool "support qualcomm boot"
	
if QUALCOMM_BOOT
config BOOTLOADER_VENDOR
	string
	default "QUALCOMM"

choice
	prompt "qualcomm boot edition"
	
config QUALCOMM_BOOT_1_000
	bool "qualcomm boot 1.000"

endchoice

endif
```

## Hybrid_GPL_5115/Hybrid_security_baseline/driver/Config.in
```kconfig
menu "Hardware chip config"

choice
	prompt "Choose hardware chip"

config BROADCOM_CHIP
	bool "Support broadcom chip"
	help
	  Enable this option if you use broadcom chip

config MTK_CHIP
	bool "Support mtk chip"
	help
	  Enable this option if you use mtk chip

config REALTEK_CHIP
	bool "Support realtek chip"
	help
	  Enable this option if you use realtek chip

config HISI_CHIP
	bool "Support hisi Chip"
	help
		Enable this option if you use hisi chip

config QUALCOMM_CHIP
	bool "Support qualcomm chip"
	help
		Enable this option if you use qualcomm chip

endchoice

config CHIP_PRODUCT_NAME
	string "chip product name"
	depends on BROADCOM_CHIP || HISI_CHIP || MTK_CHIP || REALTEK_CHIP || QUALCOMM_CHIP
	default "broadcom" if BROADCOM_CHIP=y
	default "hisi" if HISI_CHIP=y
	default "mtk" if MTK_CHIP=y
	default "realtek" if REALTEK_CHIP=y
	default "qualcomm" if QUALCOMM_CHIP=y
	help
	  This is the chip product name.	
	
#if BROADCOM_CHIP
#	 source "package/atp/driver/broadcom/Config.in"
#endif

#if MTK_CHIP
# 	source "package/atp/driver/mtk/Config.in"
#endif

#if REALTEK_CHIP
# 	source "package/atp/driver/realtek/Config.in"
#endif

if HISI_CHIP
	source "package/atp/driver/hisi/Config.in"
endif

#if QUALCOMM_CHIP
# 	source "package/atp/driver/qualcomm/Config.in"	
#endif
	
	source "package/atp/driver/component/Config.in"
endmenu
```

## Hybrid_GPL_5115/Hybrid_security_baseline/driver/component/Config.in
```kconfig
config BUILD_COMPONENT
	bool "Support Hardware Component"
	default n
	
#menu "Hardware Component Set"
config BUILD_COMPONENT_WLAN
	bool "Support Componet Wlan"
	default n
	depends on BUILD_COMPONENT
	
config BUILD_COMPONENT_WLAN_CHIP
	string "Component wlan Chip"
	default "bcm43217" if HISI_CHIP
	depends on BUILD_COMPONENT_WLAN
	
#endmenu
```

## Hybrid_GPL_5115/Hybrid_security_baseline/driver/hisi/Config.in
```kconfig
config ATP_CHIP_NAME
	string "Set hisi Chip"
	default "sd5115"

config BUILD_HISI_LAN2WAN
	bool "eth0.2 set to nas1"
	default n

config ATP_SUPPORT_4M_NORFLASH_PROTECT
	bool "4Mb norFLASH write protect"
	default n 
```

## Hybrid_GPL_5115/Hybrid_security_baseline/fs/squashfs/Config.in
```kconfig
config BR2_TARGET_ROOTFS_SQUASHFS
	bool "squashfs root filesystem"
	help
	  Build a squashfs root filesystem

if BR2_TARGET_ROOTFS_SQUASHFS
choice
	prompt "SquashFS version"
	default BR2_TARGET_ROOTFS_SQUASHFS4
	help
	  Select the Squash filesystem version to use to generate the
	  root filesystem.

config BR2_TARGET_ROOTFS_SQUASHFS4
       bool "4.2"
       
config BR2_TARGET_ROOTFS_SQUASHFS4_0
       bool "4.0"

config BR2_TARGET_ROOTFS_SQUASHFS3
       depends on BR2_DEPRECATED
       bool "3.x"

config BR2_TARGET_ROOTFS_SQUASHFS2
       bool "2.x"

endchoice

config ATP_SQUASHFS_VERSION
       string
	   default "4.2" if BR2_TARGET_ROOTFS_SQUASHFS4
	   default "4.0" if BR2_TARGET_ROOTFS_SQUASHFS4_0
	   default "2.0" if BR2_TARGET_ROOTFS_SQUASHFS2
	   help
	     Squashfs tool's version


choice
	prompt "Compression algorithm"
	default BR2_TARGET_ROOTFS_SQUASHFS4_GZIP
	depends on BR2_TARGET_ROOTFS_SQUASHFS4
	help
	  Select the squashfs compression algorithm to use when
	  generating the filesystem.

config BR2_TARGET_ROOTFS_SQUASHFS4_GZIP
       bool "gzip"

config BR2_TARGET_ROOTFS_SQUASHFS4_LZMA
       bool "lzma"

config BR2_TARGET_ROOTFS_SQUASHFS4_LZO
       bool "lzo"

config BR2_TARGET_ROOTFS_SQUASHFS4_XZ
       bool "xz"

endchoice
endif
```

## Hybrid_GPL_5115/Hybrid_security_baseline/linux/2.6.30/arch/arm/mach-sd5115/Kconfig
```kconfig
# define a global config variable
config HISI_SD5115
        bool "Hisilicon sd5115 define macro"
        depends on 0

menu "SD5115 platform feature"
config MACH_SD5115
	bool "Support SD5115 platform"
	select CPU_V7
	select ARM_GIC
	select OUTER_CACHE
	select OUTER_CACHE_SYNC
	select HISI_SD5115
	help
	  Include support for the hisilion godbox platform.

config B880_PRODUCT
	bool "Support b880 product"

menu "chip version select (for develpor only)"
choice
	prompt "SD5115 MPW or PILOT"
	default HISI_SD5115_MP_MPW
	config HISI_SD5115_MP_PILOT
		bool "HISI_SD5115_MP_PILOT"
	config HISI_SD5115_MP_MPW
		bool "HISI_SD5115_MP_MPW"
endchoice
choice
	prompt "SD5115 type"
	depends on HISI_SD5115_MP_PILOT
	default HISI_SD5115_TYPE_H
	config HISI_SD5115_TYPE_H
		bool "HISI_SD5115_TYPE_H"
	config HISI_SD5115_TYPE_S
		bool "HISI_SD5115_TYPE_S"
	config HISI_SD5115_TYPE_T
		bool "HISI_SD5115_TYPE_T"
endchoice
choice
	prompt "SD5115 ASIC or FPGA"
	default HISI_SD5115_AF_ASIC
	config HISI_SD5115_AF_ASIC
		bool "HISI_SD5115_AF_ASIC"
	config HISI_SD5115_AF_FPGA
		bool "HISI_SD5115_AF_FPGA"
		depends on !HISI_SD5115_MP_MPW
endchoice
choice
	prompt "SD5115 version"
	default HISI_SD5115_VER_100
	config HISI_SD5115_VER_100
		bool "HISI_SD5115_VER_100"
endchoice
endmenu

config HISILICON_KCONSOLE
	int "Kernel console( 0 => UART0, 1 => UART1)"
	range 0 1
	default 0
	help
	  Select uart port as the default console used by kernel
config HISILICON_EDB_LEVEL
	int "Kernel Early-Debug Level( 0~254, 255 => Disable Early-Debug)"
	range 0 255
	default 255
	help
	  Set the debug level of Early-Debug, low level will cause more debug message
config DEFAULT_BUSCLK
	int "DEFAULT_BUSCLK"
	default "50000000"
	help
      	Default AHB clock rate

endmenu
```

## Hybrid_GPL_5115/Hybrid_security_baseline/linux/2.6.30/drivers/mtd/devices/hisfc300/Kconfig
```kconfig
#
# hisilicon spi flash controller device version 300
#

menuconfig MTD_HISI_SD5115_SFC
	bool "hisilicon spi flash controller device driver"
	depends on HISI_SD5115
	help
	  hisilicon spi flash controller device version 300.

config MTD_HISI_SD5115_SFC_BUFFER_BASE_ADDRESS
	hex "hisilicon spi flash controller read/write memory base address"
	depends on MTD_HISI_SD5115_SFC
	default "0x1C000000"

config MTD_HISI_SD5115_SFC_REG_BASE_ADDRESS
	hex "hisilicon spi flash controller register base address"
	depends on MTD_HISI_SD5115_SFC
	default "0x10A20000"

config MTD_HISI_SD5115_SFC_PERIPHERY_REGBASE
	hex "hisilicon spi flash controller periphery register base address(clk)"
	depends on MTD_HISI_SD5115_SFC
	default "0"
	
config MTD_HISI_SD5115_SFC_CHIPNUM
	int "hisilicon spi flash controller chip number"
	depends on MTD_HISI_SD5115_SFC
	default 2
```

## Hybrid_GPL_5115/Hybrid_security_baseline/linux/2.6.30/drivers/mtd/nand/hinfc301/Kconfig
```kconfig
#
# drivers/mtd/nand/hinfc301/Kconfig
# add by caizhiyong 2010.11.04
#

menu "Hisilicon NAND Controller device Support"

config MTD_HISI_SD5115_NFC
    bool "Support SD5115 NAND Controller device"
    depends on MTD_NAND
    depends on HISI_SD5115
    select YAFFS_FS
    select MISC_FILESYSTEMS
    select MTD_BLOCK
    select YAFFS_YAFFS2
    help
	 Hisilicon NAND Controller device Support
      
config MTD_HISI_SD5115_NFC_REG_BASE_ADDRESS
	hex "nand controller's register base address"
	depends on MTD_HISI_SD5115_NFC
	default 0x10A30000
	help
	  register base address of nand controller

config MTD_HISI_SD5115_NFC_BUFFER_BASE_ADDRESS
	hex "nand controller's buffer base address"
	depends on MTD_HISI_SD5115_NFC
	default 0x20000000
	help
	  buffer base address of nand controller
	  
config MTD_HISI_SD5115_NFC_PERIPHERY_REGBASE
	hex "nand controller's peripher base address"
	depends on MTD_HISI_SD5115_NFC
	default 0x0
	help
	  peripher base address of nand controller,for clk setting

config MTD_HISI_SD5115_NFC_MAX_CHIP
    int "number of nand flash chip (1,4)"
	depends on MTD_HISI_SD5115_NFC
    default 1
    help
      nand controller v301 device only support 1 or 2 nand flash chip,
      your should not config other value.   
    
config MTD_HISI_SD5115_NFC_DBG_PROC_FILE
    bool "debug: create /proc/nand file"
	depends on MTD_HISI_SD5115_NFC
    help
      export /proc/nand file for debug.
      
config MTD_HISI_SD5115_NFC_DBG_EC_NOTICE
    bool "debug: notice uncorrectable error"
	depends on MTD_HISI_SD5115_NFC
    help
      notice nand uncorrectable error
      
choice
    prompt "Pagesize and Ecc Type Select"
    
config MTD_HISI_SD5115_NFC_HARDWARE_PAGESIZE_ECC
    bool "Hardware"
	depends on MTD_HISI_SD5115_NFC
    help
      pagesize and ecc type use hardware config
      
config MTD_HISI_SD5115_NFC_AUTO_PAGESIZE_ECC
    bool "Auto"
	depends on MTD_HISI_SD5115_NFC
    help
      pagesize and ecc type use hardware config
      
config MTD_HISI_SD5115_NFC_PAGESIZE_AUTO_ECC_NONE
    bool "Pagesize Auto, Ecc None"
	depends on MTD_HISI_SD5115_NFC
    help
      select pagesize 2K, ecc none.
     
endchoice

endmenu
```

## Hybrid_GPL_5115/Hybrid_security_baseline/linux/2.6.30/drivers/pci/hipciev100/Kconfig
```kconfig
if HISI_SD5115

menuconfig PCIE0_HISI_SD5115
	bool "Hisilicon PCIE0 Express support"
	depends on PCI
	help
	  Hisilicon PCI Express support

config PCIE0_SEL
        int "PCI Express controller0 sel"
        depends on PCIE0_HISI_SD5115
        range 0 1
        default "1"        
        help
        PCI Express controller0 sel. Set 0 to disable controller,
	        set 1 to let controller0 work at x1 mode.

config PCIE0_DEVICES_MEM_SIZE
        hex "Total memory size of PCI Express system devices"
        depends on PCIE0_HISI_SD5115
        range 0x0 0x7800000 
        default "0x400000" 
        help
        All memory size requeired by all devices in pci subsystem.
        Hisilicon PCI Express controller provide up to 128M memory
        and io size for device.
        Here we set memory size up to 120M, means that io size has at least 8M
        You can change this depend on you device connected
        to Hisilicon PCI Express controller.

config PCIE0_DEVICES_CONFIG_SIZE
        hex "Total configuration header size of PCI Express system devices"
        depends on PCIE0_HISI_SD5115
        range 0x0 0x10000000   
        default 0x80000       
        help
        All configuration size required by devices connnect to
        Hisilicon PCI Express controller.
        NOTE: This will alloc memory from kernel,
        enlarge this will require the same memory.
        The default value is enough for most applications.

endif
```

## Hybrid_GPL_5115/Hybrid_security_baseline/linux/2.6.30/drivers/pci/hipciev101/Kconfig
```kconfig
if HISI_SD5115

menuconfig PCIE1_HISI_SD5115
	bool "Hisilicon PCIE1 Express support"
	depends on PCI
	help
	  Hisilicon PCI Express support
	  
config PCIE1_SEL
        int "PCI Express controller1 sel"
        depends on PCIE1_HISI_SD5115
        range 0 1
        default "1"        
        help
        PCI Express controller1 sel. Set 0 to disable controller,
	        set 1 to let controller1 work at x1 mode.

config PCIE1_DEVICES_MEM_SIZE
        hex "Total memory size of PCI Express system devices"
        depends on PCIE1_HISI_SD5115
        range 0x0 0x7800000 
        default "0x400000" 
        help
        All memory size requeired by all devices in pci subsystem.
        Hisilicon PCI Express controller provide up to 128M memory
        and io size for device.
        Here we set memory size up to 120M, means that io size has at least 8M
        You can change this depend on you device connected
        to Hisilicon PCI Express controller.

config PCIE1_DEVICES_CONFIG_SIZE
        hex "Total configuration header size of PCI Express system devices"
        depends on PCIE1_HISI_SD5115
        range 0x0 0x10000000  
        default 0x80000       
        help
        All configuration size required by devices connnect to
        Hisilicon PCI Express controller.
        NOTE: This will alloc memory from kernel,
        enlarge this will require the same memory.
        The default value is enough for most applications.

endif
```
