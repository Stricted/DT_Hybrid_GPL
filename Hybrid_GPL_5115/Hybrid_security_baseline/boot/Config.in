## Hybrid_GPL_5115/Hybrid_security_baseline/linux/2.6.30/drivers/usb/host/Kconfig.hiusb
```kconfig
#
# Hisilicon usb Host Controller Drivers
#
if HISI_SD5115

menuconfig USB_HISI_SD5115
	bool "hisilicon usb(ehci/ohci) family usb host device support"
	depends on (HISI_SD5115)
	select USB
	select USB_ARCH_HAS_EHCI
	select USB_ARCH_HAS_OHCI
	help
	  This selects the usb(ehci/ohci) family usb host device.

config USB_HISI_SD5115_EHCI
	bool "usb-ehci usb host device support"
	depends on (USB_HISI_SD5115)
	default y

config USB_HISI_SD5115_EHCI_IOBASE
	hex "usb-ehci IO address"
	depends on (USB_HISI_SD5115_EHCI)
	default "0x10A40000"

config USB_HISI_SD5115_EHCI_IOSIZE
	hex "usb-ehci IO size"
	depends on (USB_HISI_SD5115_EHCI)
	default "0x00010000"
	help
	  default is 0x10000.

config USB_HISI_SD5115_EHCI_IRQNUM
	int "usb-ehci irq number"
	depends on (USB_HISI_SD5115_EHCI)
	default "71"

config USB_HISI_SD5115_OHCI
	bool "usb-ohci usb host device support"
	depends on (USB_HISI_SD5115)
	default y

config USB_HISI_SD5115_OHCI_IOBASE
	hex "usb-ohci IO address"
	depends on (USB_HISI_SD5115_OHCI)
	default "0x10A50000"

config USB_HISI_SD5115_OHCI_IOSIZE
	hex "usb-ohci IO size"
	depends on (USB_HISI_SD5115_OHCI)
	default "0x00010000"
	help
	  default is 0x10000.

config USB_HISI_SD5115_OHCI_IRQNUM
	int "usb-ohci irq number"
	depends on (USB_HISI_SD5115_OHCI)
	default "70"

endif
```

## Hybrid_GPL_5115/Hybrid_security_baseline/package/Config.in
```kconfig
menu "ATP Package Selection"

# ATP all applications
source "package/atp/Config.in"
source "package/makedevs/Config.in"
source "package/uboot-tools/Config.in"

config BUILD_TRACE_CODE_DEBUG
	bool "support trace code for debug"
	default n

config BUILD_SIGNAL_LED_CONTROL
	bool "SIGNAL_LED_CONTROL"
	default n

endmenu
```

## Hybrid_GPL_5115/Hybrid_security_baseline/package/atp/Config.in
```kconfig
source "package/atp/libraries/Config.in"
source "package/atp/applications/Config.in"
source "package/atp/configuration/Config.in"
source "package/atp/network/Config.in"
source "package/atp/voice/Config.in"
source "package/atp/hosttool/package/Config.in"
```

## Hybrid_GPL_5115/Hybrid_security_baseline/package/atp/KConfig.in
```kconfig
menu "ATP Linux Kernel Extension"
config SUPPORT_ATP
	bool "Support ATP feature"
	default y
source "package/atp/applications/KConfig.in"
source "package/atp/network/KConfig.in"
source "package/atp/libraries/KConfig.in"
source "package/atp/driver/Config.in"
endmenu
```

## Hybrid_GPL_5115/Hybrid_security_baseline/package/atp/applications/Config.in
```kconfig
menu "ATP Applications"
source "package/atp/applications/datacard/Config.in"
source "package/atp/applications/usbmount/Config.in"
source "package/atp/applications/filesystem/Config.in"
source "package/atp/applications/dlna/Config.in"
source "package/atp/applications/itunes/Config.in"
source "package/atp/applications/ftpclient/Config.in"
source "package/atp/applications/tr143/Config.in"
source "package/atp/applications/ledservice/Config.in"
source "package/atp/applications/powermanagement/Config.in"
source "package/atp/applications/sms/Config.in"
source "package/atp/applications/nas/Config.in"
source "package/atp/applications/usbdiagd/Config.in"
source "package/atp/applications/oam/Config.in"
source "package/atp/applications/keyled/Config.in"
source "package/atp/applications/wirelinemonitor/Config.in"
source "package/atp/applications/notify/Config.in"
source "package/atp/applications/timereboot/Config.in"
source "package/atp/applications/usbom/Config.in"
endmenu
```

## Hybrid_GPL_5115/Hybrid_security_baseline/package/atp/applications/KConfig.in
```kconfig
menu "Applications Linux Kernel Extension"
source "package/atp/applications/datacard/KConfig.in"
endmenu
```

## Hybrid_GPL_5115/Hybrid_security_baseline/package/atp/applications/datacard/kernel/Config.in
```kconfig
config BUILD_AT_KERNEL
	bool "at kernel"
	depends on BUILD_AT
	default n
	help
	  Select support for datacard service about kernel
```

## Hybrid_GPL_5115/Hybrid_security_baseline/package/atp/configuration/debug/Config.in
```kconfig
menu "ATP Debug Supported Selection"
config BUILD_COREDUMP
	bool "Support coredump"
	default n
config ATP_COREDUMP_FILE_SIZE
	int "define coredump file size(K)"
	depends on 	BUILD_COREDUMP
	default 200
	
config ATP_COREDUMP_DIR
	string "define coredump dir"
	depends on BUILD_COREDUMP
	default "/config/coredump"
	
endmenu
```

## Hybrid_GPL_5115/Hybrid_security_baseline/package/atp/hosttool/package/Config.in
```kconfig
menu "Package Image"
config BUILD_PKGIMAGE
	bool "Package Image"
	default y

if BUILD_PKGIMAGE
source "package/atp/hosttool/package/pkg/Config.in"
if BROADCOM_CHIP
source "package/atp/hosttool/package/bcm/Config.in"
endif
source "package/atp/hosttool/package/mlzma/Config.in"
source "package/atp/hosttool/package/qlzma/Config.in"
source "package/atp/hosttool/package/sign/Config.in"
source "package/atp/hosttool/package/addecc/Config.in"
endif
endmenu
```

## Hybrid_GPL_5115/Hybrid_security_baseline/package/atp/hosttool/package/pkg/Config.in
```kconfig
config BUILD_ATPPKG
	bool "ATP Package Tools"
	default y
	depends on BUILD_PKGIMAGE

choice
	prompt "Inifile Select"
	config BUILD_AUTO_GEN_INI
		bool "Auto Generate Ini File"
		
	config BUILD_CUSTOMER_INI
		bool "Customer Ini File"
	
endchoice

if BUILD_CUSTOMER_INI
	config BUILD_CUSTOMER_INI_PATH
	string "Customer Ini File Path"
	default "package/atp/hosttool/package/pkg/config.ini"
endif
```
