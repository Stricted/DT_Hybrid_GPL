## Hybrid_GPL_63168/DT-W724V-20140311/boot/mtk/Config.in
```kconfig
config MTK_BOOT
	bool "support mtk boot"
	depends on MTK_CHIP

if MTK_BOOT
config BOOTLOADER_VENDOR
	string 
	default "MTK"
	
choice
	prompt "MTK boot edition"
	
config MTK_BOOT_1_000
	bool "MTK boot 1.000"

endchoice

config MTK_BOOT_DEFAULT_BOOTLINE
	string "set MTK default bootline"
	default "e=192.168.1.1:ffffff00 h=192.168.1.100 g= r=f f=vmlinux i=bcm963xx_fs_kernel d=1 p=0 "

endif
```

## Hybrid_GPL_63168/DT-W724V-20140311/boot/qualcomm/Config.in
```kconfig
config QUALCOMM_BOOT
    bool "support qualcomm boot"
	
if QUALCOMM_BOOT
config BOOTLOADER_VENDOR
	string
	default "QUALCOMM"

choice
	prompt "qualcomm boot edition"
	
config QUALCOMM_BOOT_9_2
	bool "qualcomm boot 9.2"

config QUALCOMM_BOOT_9_5
	bool "qualcomm boot 9.5"
	
endchoice

endif
```

## Hybrid_GPL_63168/DT-W724V-20140311/driver/Config.in
```kconfig
menu "Hardware chip config"

choice
	prompt "Choose hardware chip"

config BROADCOM_CHIP
	bool "Support broadcom chip"
	help
	  Enable this option if you use broadcom chip

config MTK_CHIP
	bool "Support mtk chip"
	help
	  Enable this option if you use mtk chip

config REALTEK_CHIP
	bool "Support realtek chip"
	help
	  Enable this option if you use realtek chip

config HISI_CHIP
	bool "Support hisi Chip"
	help
		Enable this option if you use hisi chip

config QUALCOMM_CHIP
	bool "Support qualcomm chip"
	help
		Enable this option if you use qualcomm chip

endchoice

config CHIP_PRODUCT_NAME
	string "chip product name"
	depends on BROADCOM_CHIP || HISI_CHIP || MTK_CHIP || REALTEK_CHIP || QUALCOMM_CHIP
	default "broadcom" if BROADCOM_CHIP=y
	default "hisi" if HISI_CHIP=y
	default "mtk" if MTK_CHIP=y
	default "realtek" if REALTEK_CHIP=y
	default "qualcomm" if QUALCOMM_CHIP=y
	help
	  This is the chip product name.	
	
if BROADCOM_CHIP
	source "package/atp/driver/broadcom/Config.in"
endif


endmenu
```

## Hybrid_GPL_63168/DT-W724V-20140311/driver/broadcom/Config.in
```kconfig
choice
	prompt "Choose broadcom chip"
	default BCM96362
config BCM96368
	bool "Support broadcom BCM96368 chip"	
	help
	  Enable this option if you use broadcom BCM96368 chip

config BCM96816
	bool "Support broadcom BCM96816 chip"	
	help
	  Enable this option if you use broadcom BCM96816 chip

config BCM96362
	bool "Support broadcom BCM96362 chip"	
	help
	  Enable this option if you use broadcom BCM96362 chip	  
	  
config BCM96328
	bool "Support broadcom BCM96328 chip"	
	help
	  Enable this option if you use broadcom BCM96328 chip	  

config BCM963268
	bool "Support broadcom BCM963268 chip"	
	help
	  Enable this option if you use broadcom BCM963268 chip	  	  	  

config BCM96318
	bool "Support broadcom BCM96318 chip"	
	help
	  Enable this option if you use broadcom BCM96318 chip	 

endchoice

config BRCM_CHIP_NAME
	string "broadcom chip name"
	default "bcm963268" if BCM963268
	default "bcm96362" if BCM96362
	default "bcm96318" if BCM96318

config ATP_CHIP_NAME
	string 
	default BRCM_CHIP_NAME

config BRCM_CHIP
	int "broadcom chip name"
	default 63268 if BCM963268
	default 6362 if BCM96362
	default 6318 if BCM96318
	
choice 
	prompt "Choose broadcom release version"

	default BROADCOM_RELEASE_VERSION_4_12
	help
	  Select Broadcom release version

	config BROADCOM_RELEASE_VERSION_4_12
		bool "Broadcom release version 4.12"
	config BROADCOM_RELEASE_VERSION_4_12_L06
		bool "Broadcom release version 4.12L06"
	config BROADCOM_RELEASE_VERSION_4_12_L07
		bool "Broadcom release version 4.12L07"
	config BROADCOM_RELEASE_VERSION_4_12_L08
		bool "Broadcom release version 4.12L08"
	config BROADCOM_RELEASE_VERSION_4_13
		bool "Broadcom release version 4.13"
	config BROADCOM_RELEASE_VERSION_4_14_L02
		bool "Broadcom release version 4.14L02"

endchoice

config BROADCOM_RELEASE_VERSION
	string
	default "4.12" if BROADCOM_RELEASE_VERSION_4_12
	default "4.12L06" if BROADCOM_RELEASE_VERSION_4_12_L06
	default "4.12L07" if BROADCOM_RELEASE_VERSION_4_12_L07
	default "4.12L08" if BROADCOM_RELEASE_VERSION_4_12_L08
	default "4.13" if BROADCOM_RELEASE_VERSION_4_13
	default "4.14L02" if BROADCOM_RELEASE_VERSION_4_14_L02
	depends on (BROADCOM_RELEASE_VERSION_4_12 ||  BROADCOM_RELEASE_VERSION_4_13 || BROADCOM_RELEASE_VERSION_4_12_L06 || BROADCOM_RELEASE_VERSION_4_12_L07 || BROADCOM_RELEASE_VERSION_4_12_L08 || BROADCOM_RELEASE_VERSION_4_14_L02)
	help
	  broadcom release version

if BCM963268
source "driver/broadcom/bcm963268/Config.in"
endif



config BRCM_DAYING_GASP
	bool "Support broadcom daying gasp"
	default n
	help	
	  This options enables broadcom dayinggasp
	  
config ATP_BRCM
	bool "Support atp modify broadcom"
	default y
	help	
	  This options enables broadcom dayinggasp	  
```

## Hybrid_GPL_63168/DT-W724V-20140311/driver/broadcom/bcm963268/Config.in
```kconfig
menu "bcm963268 chip components selection"
config BCM_ENDPOINT
	tristate "Support Bcm Voice Endpoint Driver"
	default m
	depends on BUILD_VOICE
	help
	  Enable this option if you need support broadcom endpoint
	  
config BCM_BPM
	tristate "Support bcm bpm"
	default m
	help
	  Enable this option if you need support broadcom bpm
	  	  
config ETHERNET
	tristate "Support bcm ethernet"
	default m
	help
	  Enable this option if you need support broadcom ethernet
	  
config BCM_GMAC
	bool "Support for GMAC"
	default 0
	help
	  Enable this option if you need support broadcom gmac
	  
if ETHERNET
menu "ETHERNET detail configurations"
config BCM_EXT_SWITCH
	int "Support bcm external lanswitch"
	default 0
	help
	  Enable this option if you need support broadcom external lanswitch
	  
config BRCM_EXT_SWITCH_REV
	string "Support bcm ext lanswitch rev"
	default ""
	help
	  Enable this option if you need support broadcom ext lanswitch rev

	
endmenu
endif	  
	  

config BCM_PKTFLOW
	tristate "Support bcm pktflow"
	default m
	help
	  Enable this option if you need support broadcom pktflow

config BRCM_DRIVER_FAP
	bool "Support bcm driver fap"
	default y
	help
	  Enable this option if you need support broadcom driver fap
	  
config BCM_FAP
	tristate "Support for Forward Assist Processor (FAP)"
	default m
	help
		Say 'M' to include support for FAP.
		Static compile not supported.

config BCM_FAP_GSO
        bool "Support GSO in FAP"
        depends on BCM_FAP

	  
config BCM_INGQOS
	tristate "Support bcm ingqos"
	default m
	help
	  Enable this option if you need support broadcom ingqos	  

config BRCM_P8021AG
	bool "Support bcm p8021ag"
	default y
	help
	  Enable this option if you need support broadcom p8021ag

config BCM_VLAN
	tristate "Support bcm vlan"
	default n
	help
	  Enable this option if you need support broadcom vlan
	  
config DRIVER_QOS
	bool "Bcm driver Qos"
	default n
	help
	  Support Driver Ingress Qos
	  
config DSCP_QOS
	bool "Dscp statistics Qos"
	default n
	help
	  Support Dscp statistics

config WLAN
	tristate "Support bcm wlan"
	default m
	help
	  Enable this option if you need support broadcom wlan

config WLAN_DT	  
	bool "Support DT W724v wlan"
	depends on WLAN
	default n
	help
	  Enable this option if you need support DT W724v broadcom wlan
  
	  
config VDSL_VECTORING
	bool "Support VDSL Vectoring"
	default n
	help
	  Support VDSL Vectoring
	
config ADSL_ANNEX_B
	bool "Support ADSL Annex-B"
	default n
	help
	  Support ADSL Annex-B
config BCM_DSL_GINP_RTX
	tristate "Support for DSL_GINP_RTX"
	default n
	help
	  Support for DSL_GINP_RTX
	  	  
config BCM_PWRMNGT
	tristate "Support for Power Management"
	default n
	help
	  Support Broadcom power save

config BCM_ETH_PWRSAVE
    bool "Support for Ethernet Auto Power Down and Sleep"
	default n
	help
	  Support for Ethernet Auto Power Down and Sleep  
		  
config BCM_ETH_HWAPD_PWRSAVE
    bool "Support for Ethernet HW Auto Power Down for external PHYs"
	default n
	help
	  Support for Ethernet HW Auto Power Down for external PHYs  
		
config BCM_HOSTMIPS_PWRSAVE
    bool "Support for PWRMNGT MIPS clock divider"
	default n
	help
	  Support for PWRMNGT MIPS clock divider
		
config BCM_DDR_SELF_REFRESH_PWRSAVE
    bool "Support for DRAM Self Refresh mode"
	default n
	help
	  Support for DRAM Self Refresh mode
		
config BCM_AVS_PWRSAVE
    bool "Support for Automatic Voltage Scaling"
	default n
	help
	  Support for Automatic Voltage Scaling
		
config BCM_1V2REG_AUTO_SHUTDOWN
	bool "Support for Automatically Shutting down Internal 1.2V Regulator"
	default n
	help
	  Support for Automatically Shutting down Internal 1.2V Regulator
		 
config BCM_1V8REG_ALWAYS_SHUTDOWN
	bool "Support for Internal 1P8 VREG is forced to be shutdown"
	depends on BCM963268
	
config BCM_TMS
	tristate "Support bcm tms"
	default m
	help
	  Enable this option if you need support broadcom tms
		  
	  
if WLAN
menu "WLAN detail configurations"
config WIRESSTOOLS
	bool "Support bcm wirelesstools"
	default y
	help
	  Enable this option if you need support broadcom wirelesstools
	  
config BCMACS
	bool "Support bcm bcmacs"
	default y
	help
	  Enable this option if you need support broadcom bcmacs

config WPS
	bool "Support bcm wps"
	default y
	help
	  Enable this option if you need support broadcom wps

config MBSS
	bool "Support bcm mbss"
	default y
	help
	  Enable this option if you need support broadcom wbss
	
config WLAN_BUTTON
	bool "Support bcm wlan button"
	default y
	help
	  Enable this option if you need support broadcom wlan button
endmenu
endif
endmenu
```

## Hybrid_GPL_63168/DT-W724V-20140311/linux/3.4.11/Kconfig.hw
```kconfig
config ATP_USB_ADAPTOR
	bool "atp usb adaptor"
	default n

config INTERNET_LED_SINGTEL
	bool "Internet Led"
	default n 
	depends on BCM96362	
		
	
config BCM96362_DAYINGGASP
	bool "Implementation daying gasp"
    depends on BCM96362
	default n
	help	
	  This options enables the support of dayinggasp		  
```
