## Hybrid_GPL_63168/DT-W724V-20140311/package/atp/KConfig.in
```kconfig
menu "ATP Linux Kernel Extension"
config SUPPORT_ATP
	bool "Support ATP feature"
	default y
config ATP_COMMON
	bool "Support ATP feature"
	default y
config DT_COMMON
	bool "Support DT feature"
	default n
config ATP_KERNEL_3_4
	bool "Support ATP linux 3.4 feature"
	default y
source "package/atp/applications/KConfig.in"
source "package/atp/configuration/KConfig.in"
source "package/atp/network/KConfig.in"
source "package/atp/libraries/KConfig.in"
source "package/atp/driver/Config.in"
endmenu
```

## Hybrid_GPL_63168/DT-W724V-20140311/package/atp/applications/Config.in
```kconfig
menu "ATP Applications"
source "package/atp/applications/datacard/Config.in"
source "package/atp/applications/usbmount/Config.in"
source "package/atp/applications/filesystem/Config.in"
source "package/atp/applications/dlna/Config.in"
source "package/atp/applications/itunes/Config.in"
source "package/atp/applications/ftpclient/Config.in"
source "package/atp/applications/tr143/Config.in"
source "package/atp/applications/ledservice/Config.in"
source "package/atp/applications/powermanagement/Config.in"
source "package/atp/applications/nas/Config.in"
source "package/atp/applications/oam/Config.in"
endmenu
```

## Hybrid_GPL_63168/DT-W724V-20140311/package/atp/applications/KConfig.in
```kconfig
menu "Applications Linux Kernel Extension"
source "package/atp/applications/ledservice/KConfig.in"
source "package/atp/applications/datacard/KConfig.in"
endmenu
```

## Hybrid_GPL_63168/DT-W724V-20140311/package/atp/applications/datacard/Config.in
```kconfig
config BUILD_ATSERVER
	bool
	help
		Select support for datacard service about atserver

config BUILD_ATSERVERSDK
	bool
	help
	  Select the atserver sdk support

config BUILD_ATCMD
	bool
	help
	  Select support for datacard service about atcmd

config BUILD_ATCMDSDK
	bool
	help
	  Select support for datacard service about atcmd sdk

config BUILD_AT
	bool "DATACARD"
	select BUILD_ATSERVER
	select BUILD_ATSERVERSDK
	select BUILD_ATCMD
	select BUILD_ATCMDSDK
	select BUILD_ATSHARED
	default n
	help
	  Select support for datacard service

config BUILD_CUSTOM_FMC_PRODUCT
	bool "Support fmc product atserver"
	depends on BUILD_AT
	default y
	help
	  Select support FMC server	  
	  
config BUILD_LTE_FIRST
	bool "support LTE first"
	depends on BUILD_NDIS
	default n	
	help
	  Select support LTE first	  
config BUILD_3G_FIRST
	bool "support 3G first"
	depends on BUILD_AT
	default y	
	help
	  Select support 3G first

config BUILD_PIN_MNG
	bool "support auto active pin"
	depends on BUILD_AT
	default y	
	help
	  Select support auto active pin

config BUILD_MULTI_PIN_MNG
	bool "support auto multi active pin"
	depends on BUILD_PIN_MNG
	default y	
	help
	  Select support auto multi active pin

if BUILD_AT
menu "Atserver Supported Selection"
config ATSERVER_INTERVAL_TIME
	int "The Time of Check system info"
	default "10"
	help
		configure time of check sysinfo
endmenu
endif
config BUILD_NDIS
	bool "Support Qmi Interface"
	depends on BUILD_AT	
	default n
	help
	  Select support NDIS interface
```

## Hybrid_GPL_63168/DT-W724V-20140311/package/atp/applications/dlna/Config.in
```kconfig
config BUILD_DMS
    bool "Support DLNA Digital Media Server"
    default n
    select BUILD_FFMPEG
    select BUILD_LIBICONV
    select BUILD_LIBUPNP
    select BUILD_SQLITE
    help
      POSIX Access Control Lists, which are used to define more
      fine-grained discretionary access rights for files and
      directories.
      This package also provides libacl.

if BUILD_DMS
menu "ATP DMS Supported Selection"
# ATP all applications

config BUILD_DMS_IPV6
    bool "Support IPV6 for DMS"
    depends on BUILD_DMS
    default n
    select BUILD_LIBUPNP_V6

config ATP_DMS_MAX_MEDIA_ITEM_D
    int "Max number of media items."
    depends on BUILD_DMS
    default 10000

config BUILD_MONITOR_MEDIA
    bool "Support monitor changes of media content."
    depends on BUILD_DMS
    default n

config BUILD_DMS_ICON
    bool "Support ATP dms icon."
    depends on BUILD_DMS
    default n
config BUILD_DMS_UPLOAD
    bool "Support ATP dms upload."
    depends on BUILD_DMS
    default n

config BUILD_DMS_FRIENDLY_NAME
    string "Support to customize dms friendly name."
    depends on BUILD_DMS
    default n
    
config BUILD_UPNP_AV_2
    bool "Support UPnP AV 2.0"
    depends on BUILD_DMS
    default y

config BUILD_DMS_DYNAMIC_TOPFOLDER
    bool "Support dynamic top folder"
    depends on BUILD_DMS
    default n

config BUILD_DMS_PNPX
    bool "Support microsoft PnP-X"
    depends on BUILD_DMS_DYNAMIC_TOPFOLDER
    default n

if BUILD_DMS_PNPX
menu "ATP DMS PnP-x Infomation"
    config DMS_PNPX_VENDORID
        string "PnP-x vendor ID"
        depends on BUILD_DMS_PNPX
        default "1234"

    config DMS_PNPX_DEVICEID
        string "PnP-x Device ID"
        depends on BUILD_DMS_PNPX
        default "725"

    config DMS_PNPX_SUBSYSID
        string "PnP-x SubSystem ID"
        depends on BUILD_DMS_PNPX
        default "01"

    config DMS_PNPX_COMPATIBLEID
        string "PnP-x compatible ID"
        depends on BUILD_DMS_PNPX
        default "PnPX_Compatible_Router_Huawei"
endmenu
endif

endmenu
endif
```

## Hybrid_GPL_63168/DT-W724V-20140311/package/atp/applications/filesystem/kernel/Config.in
```kconfig
config BUILD_FILESYSTEM_SELECTION
	bool "Support Filesystem selection"
	default y
	help
		Select support for selection of filesystem,meanwhile it will open kernel switch

if BUILD_FILESYSTEM_SELECTION
menu "FileSystem Supported Selection"

config ATP_STOSER_SUPPORTED_FILESYSTEM_TYPES
	string  "Set storage supported filesystem types"
	default "FAT,FAT32,NTFS,HFS+,EXT2,EXT3"
	help
	  Set storage supported filesystem types

#支持NTFS
config BUILD_NTFS
	bool "SUPPORT NTFS"
	default n
	help
		Select support for NTFS,meanwhile,it will open the kernel switch about NTFS

#支持HFS
config BUILD_KERNEL_HFS_FS
	bool "SUPPORT HFS"
	default n
	help
		Select support for HFS,meanwhile,it will open the kernel switch about HFS

#支持HFS+
config BUILD_KERNEL_HFSPLUS_FS
	bool "SUPPORT HFSPLUS"
	default n
	help
		Select support for HFSPLUS,meanwhile,it will open the kernel switch about HFSPLUS

#支持EXT2
config BUILD_KERNEL_EXT2_FS
	bool "SUPPORT EXT2"
	default n
	help
		Select support for EXT2,meanwhile,it will open the kernel switch about EXT2

#支持EXT3
config BUILD_KERNEL_EXT3_FS
	bool "SUPPORT EXT3"
	default n
	help
		Select support for EXT3,meanwhile,it will open the kernel switch about EXT3

endmenu
endif
```

## Hybrid_GPL_63168/DT-W724V-20140311/package/atp/applications/ledservice/Config.in
```kconfig
config BUILD_LEDSERVICE
	bool "Support Led Service"
	default n

menu "WAN LED Status Selection"
config WS323_MULTIWAN_LED_STATUS
	bool "MultiWAN led Status"
	default n
	depends on BUILD_LEDSERVICE
endmenu

config BUILD_DT_W724V_ONLINE_LED
	bool "Support W724v online led"
	depends on BUILD_LEDSERVICE
	default n
```

## Hybrid_GPL_63168/DT-W724V-20140311/package/atp/applications/usbmount/Config.in
```kconfig
config BUILD_USB
	bool "USB"
	default y
	help
	  Select support for usb

if BUILD_USB
menu "USB Supported Selection"
config BUILD_USBMOUNT
	bool "USBMOUNT"
	select BUILD_USBMOUNTCMS
	default y
	help
	  Select support for usbmount service

if BUILD_USBMOUNT
menu "USBMOUNT Supported Selection"

#设置字符集
config BUILD_USBMOUNT_CHARACTER
	bool "USBMOUNT CHARACTER"
	default n
	help
		Select support for character set

if BUILD_USBMOUNT_CHARACTER
choice
	prompt "Choose Character type"
	default ATP_USBMOUNT_CHARACTER_SET_CP936
	help 
		Select character set

	config ATP_USBMOUNT_CHARACTER_SET_CP936
		bool "set character-set as cp936"
	config ATP_USBMOUNT_CHARACTER_SET_CP864
		bool "set character-set as cp864"

endchoice

config ATP_USBMOUNT_CHARACTER_SET
	string
	default "cp936" if ATP_USBMOUNT_CHARACTER_SET_CP936
	default "cp864" if ATP_USBMOUNT_CHARACTER_SET_CP864
	depends on (ATP_USBMOUNT_CHARACTER_SET_CP936 ||  ATP_USBMOUNT_CHARACTER_SET_CP864)
	help

	   
endif

endmenu
endif

config BUILD_DISCONNECT_DEVICE
    bool "support disconnect usb device"
    help
      support disconnect usb device
    default n
	
source "package/atp/applications/usbstorage/Config.in"
source "package/atp/applications/usbprinter/Config.in"
source "package/atp/applications/usbmngr/Config.in"
endmenu

endif
```

## Hybrid_GPL_63168/DT-W724V-20140311/package/atp/applications/usbprinter/Config.in
```kconfig
config BUILD_USBPRINTER
	bool "USBPRINTER"
	default y
	help
	  Select support for USBPRINTER,such as IP printer, CUPS printer

config BUILD_PRINTER_NODE
    bool "usb printer support node"
    help
      usb printer support node
    default n
    depends on BUILD_USBPRINTER
	  
config BUILD_USBPRINTER_IPV6
    bool "usb printer support ipv6"
    help
      usb printer support ipv6
    default y
    depends on BUILD_USBPRINTER
    depends on BUILD_IPV6

if BUILD_USBPRINTER
choice
	prompt "Choose IPP type"
	default BUILD_USBPRINTER_IPP
	help 
		Select IP printer type

	config BUILD_USBPRINTER_IPP
		bool "IP printer"
		help
		Select IP printer
	config BUILD_CUPS
		bool "CUPS printer"
		help
		Select CUPS printer

endchoice


endif
```

## Hybrid_GPL_63168/DT-W724V-20140311/package/atp/applications/usbprinter/service/cups/Config.in
```kconfig
config BUILD_CUPS
	bool "support cups"
	default y
	help
		Select support for cups
```
