## Hybrid_GPL_63168/DT-W724V-20140311/package/atp/configuration/monitor/KConfig.in
```kconfig
config ATP_CONSOLE
    tristate "Support ATP Console Monitor"
    help
      kernel printk redirect to userspace
    default n
```

## Hybrid_GPL_63168/DT-W724V-20140311/package/atp/hosttool/package/Config.in
```kconfig
menu "Package Image"
config BUILD_PKGIMAGE
	bool "Package Image"
	default y

config PKGIMAGE_FLASH_BLOCK_SIZE
	int "Flash block size for package image"
	default "65536"
	depends on BUILD_PKGIMAGE

if BUILD_PKGIMAGE
source "package/atp/hosttool/package/pkg/Config.in"
if BROADCOM_CHIP
source "package/atp/hosttool/package/bcm/Config.in"
source "package/atp/hosttool/package/addecc/Config.in"
endif
if HISI_CHIP
source "package/atp/hosttool/package/hisi_addecc/Config.in"
endif
source "package/atp/hosttool/package/mlzma/Config.in"
source "package/atp/hosttool/package/qlzma/Config.in"
source "package/atp/hosttool/package/sign/Config.in"
endif
endmenu
```

## Hybrid_GPL_63168/DT-W724V-20140311/package/atp/hosttool/package/addecc/Config.in
```kconfig
config BUILD_ADDECC
	bool "suport add ecc"
	default n

config NAND_ECC_TYPE
	int "nand ecc type"
	depends on BUILD_ADDECC
	default 1
	help 
	    1bit-1,4bit-4,8bit-8,,12bit-12,16bit-16,24bit-24
```

## Hybrid_GPL_63168/DT-W724V-20140311/package/atp/libraries/Config.in
```kconfig
menu "Core Libraries"
source "package/atp/libraries/private/msg/debug/Config.in"
source "package/atp/libraries/private/msg/sec/Config.in"
source "package/atp/libraries/private/http/main/Config.in"
source "package/atp/libraries/private/cfm/Config.in"
source "package/atp/libraries/private/dtcenter/Config.in"
source "package/atp/libraries/private/atshared/Config.in"
source "package/atp/libraries/private/bhalapi/Config.in"
source "package/atp/libraries/private/timer/Config.in"
source "package/atp/libraries/private/stunc/Config.in"
source "package/atp/libraries/opensrc/sqlite/Config.in"
source "package/atp/libraries/opensrc/libz/Config.in"
source "package/atp/libraries/opensrc/lua/Config.in"
source "package/atp/libraries/opensrc/libupnp/Config.in"
source "package/atp/libraries/opensrc/libiconv/Config.in"
source "package/atp/libraries/opensrc/ffmpeg/Config.in"
source "package/atp/libraries/opensrc/gplutil/Config.in"
source "package/atp/libraries/opensrc/busybox/Config.in"
source "package/atp/libraries/opensrc/ssl/Config.in"
source "package/atp/libraries/opensrc/ebtables/Config.in"
source "package/atp/libraries/opensrc/iproute2/Config.in"
source "package/atp/libraries/opensrc/iptables/Config.in"
source "package/atp/libraries/opensrc/openssl/Config.in"
source "package/atp/libraries/opensrc/libosip/Config.in"
source "package/atp/libraries/opensrc/cadaver/Config.in"
source "package/atp/libraries/opensrc/esmtp/Config.in"
source "package/atp/libraries/private/testcore/Config.in"
source "package/atp/libraries/opensrc/libdaemon/Config.in"
source "package/atp/libraries/opensrc/libpcap/Config.in"
endmenu
```

## Hybrid_GPL_63168/DT-W724V-20140311/package/atp/libraries/KConfig.in
```kconfig
menu "Libraries Linux Kernel Extension"
source "package/atp/libraries/opensrc/ebtables/KConfig.in"
source "package/atp/libraries/private/bhalapi/KConfig.in"
endmenu
```

## Hybrid_GPL_63168/DT-W724V-20140311/package/atp/libraries/opensrc/ebtables/Config.in
```kconfig
config BUILD_EBTABLES
	bool "ebtables"
	depends on BUILD_LINUX
	default y
	help
	  Support ebtables.

if BUILD_EBTABLES
config ATP_EBTABLES_VERSION
       string
	   default "2.0.6" if BR2_LINUX_KERNEL_VERSION = "2.6.30"
	   default "2.0.6" if BR2_LINUX_KERNEL_VERSION = "2.6.21.5"
	   default "2.0.10.4" if BR2_LINUX_KERNEL_VERSION = "3.4.11"
	   help
	     ebtables' version
endif
```

## Hybrid_GPL_63168/DT-W724V-20140311/package/atp/libraries/opensrc/ffmpeg/Config.in
```kconfig
config BUILD_FFMPEG
    bool "Support ffmpeg image/audio/video codec"
    default n
```

## Hybrid_GPL_63168/DT-W724V-20140311/package/atp/libraries/opensrc/iproute2/Config.in
```kconfig
config BUILD_IPROUTE2
	bool "iproute2"
	default y
	help
	  Support iproute.
	  
config BUILD_IPROUTE2_TC
	bool "TC"
	default y
	depends on BUILD_IPROUTE2
	help
	  Support tc.
```

## Hybrid_GPL_63168/DT-W724V-20140311/package/atp/libraries/opensrc/iptables/Config.in
```kconfig
config BUILD_IPTABLES
	bool "iptables"
	depends on BUILD_LINUX
	default y
	help
	  Support iptables.

if BUILD_IPTABLES
config ATP_IPTABLES_VERSION
       string
	   default "1.4.16.3" if BR2_LINUX_KERNEL_VERSION = "3.4.11"
	   default "1.4.12" if BR2_LINUX_KERNEL_VERSION = "2.6.36"
	   default "1.4.0" if BR2_LINUX_KERNEL_VERSION = "2.6.30"
	   default "1.4.0.1" if BR2_LINUX_KERNEL_VERSION = "2.6.21.5"
	   help
	     iptables' version
endif
```

## Hybrid_GPL_63168/DT-W724V-20140311/package/atp/libraries/opensrc/libdaemon/Config.in
```kconfig
config BUILD_LIBDAEMON
    bool "Support libdaemon"
    default n
    help
      For eases the writing of UNIX daemon.
```

## Hybrid_GPL_63168/DT-W724V-20140311/package/atp/libraries/opensrc/libupnp/Config.in
```kconfig
config BUILD_LIBUPNP
    bool "Support upnp library"
    default n

if BUILD_LIBUPNP
menu "ATP DMS Supported Selection"
# ATP all applications

config BUILD_LIBUPNP_V6
    bool "support libupnp ipv6"
    default n
endmenu
endif
```

## Hybrid_GPL_63168/DT-W724V-20140311/package/atp/libraries/opensrc/openssl/Config.in
```kconfig
config BUILD_OPENSSL_O
	bool "Support big OpenSSL library"
	default n
	help
		Encrypt library for other programs, like ipsec-tools.
```

## Hybrid_GPL_63168/DT-W724V-20140311/package/atp/libraries/opensrc/sqlite/Config.in
```kconfig
config BUILD_SQLITE
	bool "ATP sqlite"
	help
	  POSIX Access Control Lists, which are used to define more
	  fine-grained discretionary access rights for files and
	  directories.
	  This package also provides libacl.
	  
config BUILD_LUA_SQLITE
	bool "Support lua-sqite"
	depends on BUILD_SQLITE
	depends on BUILD_LUA
	default n
```

## Hybrid_GPL_63168/DT-W724V-20140311/package/atp/libraries/opensrc/ssl/Config.in
```kconfig
config BUILD_SSL
	bool "ATP SSL"
	help
	  POSIX Access Control Lists, which are used to define more
	  fine-grained discretionary access rights for files and
	  directories.
	  This package also provides libacl.
	  
if BUILD_SSL
menu "ATP SSL Supported Selection"

# ATP all applications
choice
	prompt "SSL stack choice"
	default BUILD_POLARSSL
	help
	  Select the SSL stack you want to use.

	config BUILD_POLARSSL
		bool "Polar SSL"
		depends on BUILD_SSL
	config BUILD_OPENSSL
		bool "Open SSL"
		depends on BUILD_SSL
endchoice
config BUILD_MINISSL_X509
		bool "Mini SSL X509"
		default y
		depends on BUILD_POLARSSL
	config BUILD_MINISSL_RSA
		bool "Mini SSL RSA"
		default y
		depends on BUILD_POLARSSL
	config BUILD_MINISSL_TLS
		bool "Mini SSL TLS"
		default y
		depends on BUILD_POLARSSL
	config BUILD_MINISSL_DES3
		bool "Mini SSL DES3"
		default y
		depends on BUILD_POLARSSL
	config BUILD_MINISSL_SHA1
		bool "Mini SSL SHA1"
		default n
		depends on BUILD_POLARSSL
	config BUILD_MINISSL_SHA256
		bool "Mini SSL SHA256"
		default y
		depends on BUILD_POLARSSL
	config BUILD_MINISSL_SHA512
		bool "Mini SSL SHA512"
		default n
		depends on BUILD_POLARSSL
		
	config BUILD_HTTP_SSL
		bool "Mini http ssl"
		default y
		depends on BUILD_POLARSSL
	config BUILD_MINISSL_AES
		bool "Mini ssl AES"
		default y
		depends on BUILD_POLARSSL
	config BUILD_MINISSL_DSA
		bool "Mini ssl DSA"
		default y
		depends on BUILD_POLARSSL
	config BUILD_MINISSL_RC4
		bool "Mini ssl RC4"
		default y
		depends on BUILD_POLARSSL
	config BUILD_MINISSL_HMAC
		bool "Mini ssl HMAC"
		default y
		depends on BUILD_POLARSSL
	config BUILD_MINISSL_EXTRA
		bool "Mini ssl EXTRA"
		default y
		depends on BUILD_POLARSSL			
	config BUILD_MINISSL_CLIENT
		bool "Mini ssl client"
		default y
		depends on BUILD_POLARSSL
	config BUILD_MINISSL_SERVER
		bool "Mini ssl server"
		default y
		depends on BUILD_POLARSSL
	config BUILD_MINISSL_NONBLOCKING
		bool "Mini ssl nonblocking"
		default y
		depends on BUILD_POLARSSL
	config BUILD_OPENSSL_O
		bool "openssl_O work together with IPSEC"
		default y
		depends on BUILD_POLARSSL
endmenu
endif
```

## Hybrid_GPL_63168/DT-W724V-20140311/package/atp/libraries/private/bhalapi/Config.in
```kconfig
menu "ATP BHAL"
source "package/atp/libraries/private/bhalapi/KeyConfig.in"

config DT_MAC_SUPPORT
	bool "DT_MAC_SUPPORT"
	default n
	help
	  Support datacard service.
	  
config SUPPORT_BHAL_WITHOUTPRINT
	bool "bhal without print log"
	default n
	help
	  bhal without print log

config BUILD_BOARD_TYPE_DETECT
	bool "support boadr type detect"
	default n	
	help
	  support support boadr type detect
#START ADD: l00252599 FOR SUPPORT GPIO I2C 2013-09-05
config BUILD_GPIO_I2C
	bool "support gpio i2c"
	default n	
	help
	  support support gpio i2c	  
#END ADD: l00252599 FOR SUPPORT GPIO I2C 2013-09-05
config BUILD_WATCHDOG
	bool "support watch dog"
	default n	
	help
	  support watch dog

config BUILD_WATCHDOG_TIMER
	int "Watch Dog Timer"
	default "60"
	depends on BUILD_WATCHDOG
	help
		Watch Dog Timer
	
if 	DT_MAC_SUPPORT

choice
	prompt "Choose DT Custom Product"
	default DT_W724V_MAC_SUPPORT
	
config DT_W724V_MAC_SUPPORT
	bool "support W724v MAC distribute"	
	help
	  Enable this option if your custom DT product is W724v	

config DT_W723V_MAC_SUPPORT
	bool "support W723v MAC distribute"	
	help
	  Enable this option if your custom DT product is W723v	

endchoice 

endif	##end of GPIO_CTRL_BCM4360_RF	
endmenu	
```

## Hybrid_GPL_63168/DT-W724V-20140311/package/atp/libraries/private/bhalapi/KConfig.in
```kconfig
config HTML_PARTITION
	bool "Equip html partition (strongly recommend)"
	default y
```

## Hybrid_GPL_63168/DT-W724V-20140311/package/atp/network/Config.in
```kconfig
menu "Network Services"

source "package/atp/network/common/Config.in"
source "package/atp/network/wan/Config.in"
source "package/atp/network/wanvlan/Config.in"
source "package/atp/network/sntp/Config.in"
source "package/atp/network/dhcps/Config.in"
source "package/atp/network/arpsender/Config.in"
source "package/atp/network/ipcheck/Config.in"
source "package/atp/network/dns/Config.in"
source "package/atp/network/vlan/Config.in"
source "package/atp/network/bridge/Config.in"
source "package/atp/network/firewall/Config.in"
source "package/atp/network/igmp/Config.in"
source "package/atp/network/mld/Config.in"
source "package/atp/network/wanumts/Config.in"
source "package/atp/network/pppc/Config.in"
source "package/atp/network/route/Config.in"
source "package/atp/network/eth/Config.in"
source "package/atp/network/wlan/Config.in"
source "package/atp/network/dhcp6c/Config.in"
source "package/atp/network/dhcpc/Config.in"
source "package/atp/network/iptunnel/Config.in"
source "package/atp/network/nat/Config.in"
source "package/atp/network/qos/Config.in"
source "package/atp/network/radvd/Config.in"
source "package/atp/network/dhcp6s/Config.in"
source "package/atp/network/alg/Config.in"
source "package/atp/network/route6/Config.in"
source "package/atp/network/lanname/Config.in"
source "package/atp/network/openwifi/Config.in"
source "package/atp/network/ddns/Config.in"
source "package/atp/network/neighbordiscovery/Config.in"
source "package/atp/network/xdsl/Config.in"
source "package/atp/network/mirror/Config.in"
source "package/atp/network/privacybutton/Config.in"
source "package/atp/network/fon/Config.in"
source "package/atp/network/pcp/Config.in"
source "package/atp/network/ethdslchg/Config.in"
source "package/atp/network/pvcsearch/Config.in"
source "package/atp/network/hybrid/Config.in"
source "package/atp/network/lte/Config.in"

endmenu
```

## Hybrid_GPL_63168/DT-W724V-20140311/package/atp/network/KConfig.in
```kconfig
menu "Network Linux Kernel Extension"
source "package/atp/network/igmp/KConfig.in"
source "package/atp/network/mld/KConfig.in"
source "package/atp/network/qos/KConfig.in"
source "package/atp/network/firewall/KConfig.in"
source "package/atp/network/pppc/KConfig.in"
source "package/atp/network/hybrid/KConfig.in"
config PORT_SCAN
	bool "port scan"
	default y
config ATP_PORT_SCAN
	bool "port scan"
	default y
config ATP_DROP_ARP
	bool "drop the arp packages"
	default y
	help
	    the arp package is from wan to lan, br to wan.
config ATP_DROP_NS
	bool "drop the ns packages form lan to wan"
	default y
	help
	    See DTS2012021404606 for more detail.
	depends on ATP_KERNEL_3_4
config RESERVE_CT_SESSION
	bool "Reserve some session for certain bussiness"
	default n
config IP_NF_TARGET_PORT_TRIGGERING
	bool "Sure to support port_trigger"
	default n 
	depends on BCM963268
config ATP_DROP_OTHER_PF_PACKET
    bool "support to drop other hosts' packets received via PF_PACKET sockets"
	default y
	help
	    On default, a PF_PACKET socket will receive and process other hosts's packets. Kernel will drop these packets if this macro is open. You can see DTS2012122804018 for detail.
    depends on ATP_KERNEL_3_4
config SIPALG_RECOREDDSTIP
	bool "Support record sip alg dst ip(siproxd)"
	default n
endmenu
```

## Hybrid_GPL_63168/DT-W724V-20140311/package/atp/network/alg/Config.in
```kconfig
config BUILD_ALG
	bool "ALG"
	default y
	help
	  Support  ALG.	
	      
if BUILD_ALG
menu "ATP ALG Supported Selection"

config BUILD_SIPPXY
	bool "Sip alg"
	default y
	depends on BUILD_ALG

source "package/atp/network/alg/service/siproxd/Config.in"

config BUILD_SIPPXY_RECORDDSTIP
	bool "record dst ip"
	select SIPALG_RECOREDDSTIP
	default n
	depends on BUILD_SIPROXYD 
endmenu
endif
```

## Hybrid_GPL_63168/DT-W724V-20140311/package/atp/network/alg/service/siproxd/Config.in
```kconfig
config BUILD_SIPROXYD
    bool "Support SIP ALG through opensource siproxyd"
    depends on BUILD_SIPPXY
	select BUILD_LIBOSIP
    default n
```

## Hybrid_GPL_63168/DT-W724V-20140311/package/atp/network/bridge/Config.in
```kconfig
config BUILD_BRIDGE
	bool "BRIDGE"
	help
	  Support Bridge

if BUILD_BRIDGE
menu "ATP Bridge Supported Selection"

config ATP_BRIDGE_MAX
	int "Max number of Bridges table"
	default "4"
	depends on BUILD_BRIDGE
	help
		The maximum number of entries available in the Bridge table.
	
config ATP_BRIDGE_FILTER_MAX
	int "Max number of Filters table"
	default "30"
	depends on BUILD_BRIDGE
	help
		The maximum number of entries available in the Filter table.

config BUILD_ATH_WRAP
	bool "Support WRAP on Atheros APs"
	default n
	depends on BUILD_BRIDGE
	help
		Atheros chip: support WRAP on APs - mods to bridge adding port tye.

endmenu
endif
```
