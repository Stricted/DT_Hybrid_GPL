## Hybrid_GPL_63168/DT-W724V-20140311/package/atp/network/qos/Config.in
```kconfig
config BUILD_QOS
	bool "DT QOS"
	default n
	select BUILD_IPROUTE2
	select BUILD_IPROUTE2_TC
	help
	  Support DT_QOS 
	  
if BUILD_QOS
menu "ATP QoS Supported Selection"

config BUILD_DT_QOS
	bool "DT QOS"
	default N
	depends on BUILD_QOS
	help
	  Support DT QOS

config BUILD_BPMCTL
	bool "bcm bpmctl"
	default y
	help
	  Support Bcm Bpmctl Qos	
      
config BUILD_IQCTL
	bool "bcm iqctl"
	default y
	depends on BUILD_QOS
	help
	  Support Bcm iqctl Qos	
	  
config BUILD_FAPCTL
	bool "bcm fapctl"
	default y
	depends on BUILD_QOS
	help
	  Support Bcm Fapctl Qos	
	  
config BUILD_FCCTL
	bool "bcm fcctl"
	default y
	depends on BUILD_QOS
	help
	  Support Bcm fcctl Qos			  
endmenu
endif	  

config BUILD_QUEUE
	bool "ATP QOS"
	default y
	select BUILD_IPROUTE2
	select BUILD_IPROUTE2_TC
	help
	  Support TR098 QOS data model 
	  
  	  
if BUILD_QUEUE
menu "ATP QoS Supported Selection"
	  
config BUILD_UPLINK_QOS
	bool "Uplink Qos"
	default y
	depends on BUILD_QUEUE
	help
	  Support Uplink Qos
	  
if BUILD_UPLINK_QOS
menu "ATP Uplink_QoS Supported Selection"

config BUILD_TC_QOS
	bool "TC Qos"
	default y
	depends on BUILD_UPLINK_QOS
	help
	  Support TC qos
	  
if BUILD_TC_QOS
menu "ATP TC_Qos Supported Selection"

config BUILD_DRIVER_QOS
	bool "Driver Ingress Qos"
	default y
	depends on BUILD_TC_QOS
	depends on BROADCOM_CHIP
	select DRIVER_QOS
	help
	  Support Driver Ingress Qos

if BUILD_DRIVER_QOS
menu "ATP Driver_Ingress_Qos Supported Selection"

config BUILD_DRIVER_XTM_QOS
	bool "XTM Uplink Qos"
	default y
	depends on BUILD_DRIVER_QOS
	depends on BUILD_XDSL
	help
	  Support XTM Uplink Qos	

config BUILD_DRIVER_ETH_QOS
	bool "Eth Uplink Qos"
	default y
	depends on BUILD_DRIVER_QOS
	depends on BUILD_WANETH
	help
	  Support Eth Uplink Qos	

config BUILD_FAPCTL
	bool "bcm fapctl"
	default y
	depends on BUILD_DRIVER_QOS
	help
	  Support Bcm Fapctl Qos	
	  
config BUILD_FCCTL
	bool "bcm fcctl"
	default y
	depends on BUILD_DRIVER_QOS
	help
	  Support Bcm fcctl Qos		  
endmenu
endif
	   	  
config BUILD_UNIVERSAL_QOS
	bool "Universal Ingress Qos"
	default y
	depends on BUILD_TC_QOS
	help
	  Support Universal Ingress Qos
	  
config BUILD_QOS_IPV6
	bool "Universal IPv6 Qos"
	default n
	depends on BUILD_UNIVERSAL_QOS
	help
	  Support Universal IPv6 Qos 
	  
config BUILD_QOS_RATE_PERCENT
	bool "qos rate percent"
	default n
	depends on BUILD_UNIVERSAL_QOS
	help
	  Support set QoS rate by percent

config BUILD_UNIVERSAL_XTM_QOS
	bool "XTM Uplink Qos"
	default y
	depends on BUILD_UNIVERSAL_QOS
	depends on BUILD_XDSL
	help
	  Support XTM Uplink Qos	

config BUILD_UNIVERSAL_ETH_QOS
	bool "Eth Uplink Qos"
	default y
	depends on BUILD_UNIVERSAL_QOS
	depends on BUILD_WANETH
	help
	  Support Eth Uplink Qos

config BUILD_QUEUE_STATISTICS_QOS
	bool "Queue statistics "
	default y
	depends on BUILD_TC_QOS
	help
	  Queue statistics

endmenu
endif

config BUILD_FIX_TC_QOS
	bool "Fix Queue Num"
	default n
	depends on BUILD_UPLINK_QOS
	help
	  Support Fix Queue Num
	  
if BUILD_FIX_TC_QOS
menu "ATP Fix Queue Num Supported Selection"

config BUILD_FIX_TC_ETH_QOS
	bool "Eth Uplink Fix Queue Num"
	default n
	depends on BUILD_FIX_TC_QOS
	depends on BUILD_WANETH
	help
	  Support Eth Fix Queue Num
	  
endmenu
endif

endmenu
endif

config BUILD_DOWNLINK_QOS
	bool "Downlink Qos"
	default y
	depends on BUILD_QUEUE
	help
	  Support downlink qos

if BUILD_DOWNLINK_QOS
menu "ATP Downlink QoS Supported Selection"

config BUILD_LANSWITCH_QOS
	bool "Lanswitch Qos"
	default y
	depends on BUILD_DOWNLINK_QOS
	help
	  Support Lanswitch Qos
	  	  	  	  
config BUILD_WMM_QOS
	bool "WMM Qos"
	default y
	depends on BUILD_DOWNLINK_QOS
	help
	  Support WMM Qos
	  
config BUILD_DSCP_STATISTICS_QOS
	bool "Dscp statistics"
	default y
	depends on BUILD_DOWNLINK_QOS
	depends on BROADCOM_CHIP
	select DSCP_QOS
	help
	  Support Dscp statistics

endmenu
endif

config BUILD_POLICER_QOS
	bool "Traffic policer"
	default y
	depends on BUILD_QUEUE
	help
	  Support Traffic policer
	  
if BUILD_POLICER_QOS
menu "ATP QoS_Policer Supported Selection"

config BUILD_OPENWIFI_POLICER_QOS
	bool "Openwifi qos policer"
	default y
	depends on BUILD_POLICER_QOS
	select BUILD_OPENWIFI
	help
	  Support Traffic policer
	  
config BUILD_DOWNLINK_POLICER_QOS
	bool "Downlink policer"
	default n
	depends on BUILD_POLICER_QOS
	select DOWN_RATE_CONTROL
	help
	  Support Downlink Traffic policer	  
	  
endmenu
endif
	  	  	  	    
config BUILD_CLASS_QOS
	bool "Flow Classification"
	default y
	depends on BUILD_QUEUE
	help
	  Support Flow Classification 
	  
if BUILD_CLASS_QOS
menu "ATP QoS_Classfication Supported Selection"

config BUILD_APP_CLASS_QOS
	bool "App Classification"
	default y
	depends on BUILD_CLASS_QOS
	depends on BUILD_UPLINK_QOS
	help
	  Support App Classification 

if BUILD_APP_CLASS_QOS
menu "ATP QoS_App_Classfication Supported Selection"

config BUILD_TR069_CLASS_QOS
	bool "Tr069 Classification"
	default y
	depends on BUILD_APP_CLASS_QOS
	help
	  Support Tr069 Classification

config BUILD_VOICE_CLASS_QOS
	bool "Voice Classification"
	default y
	depends on BUILD_APP_CLASS_QOS
	help
	  Support Voice Classification

config BUILD_DT_CLASS_QOS
	bool "DT Classification"
	default y
	depends on BUILD_APP_CLASS_QOS
	depends on BUILD_XDSL
	help
	  Support DT Classification

endmenu
endif
	  
config BUILD_PKT_CLASS_QOS
	bool "Packet Classification"
	default y
	depends on BUILD_CLASS_QOS
	depends on BUILD_UPLINK_QOS
	help
	  Support Packet Classification
	  	
if BUILD_PKT_CLASS_QOS
menu "ATP QoS_Packet_Classfication Supported Selection"

config BUILD_NORM_CLASS_QOS
	bool "Common Classification"
	default y
	depends on BUILD_PKT_CLASS_QOS
	help
	  Support Common Classification	 

config BUILD_DOWNLINK_CLASS_QOS
	bool "Uplink&Downlink Classification"
	default n
	depends on BUILD_PKT_CLASS_QOS
	help
	  Support Uplink&Downlink Classification	 

config BUILD_QOS_IPV6
	bool "IPv6 Qos"
	default n
	depends on BUILD_PKT_CLASS_QOS
	help
	  Support IPv6 Qos 
	  
config BUILD_VENDORID_CLASS_QOS
	bool "VendorID Classification"
	default y
	depends on BUILD_PKT_CLASS_QOS
	help
	  Support Common Classification	


endmenu
endif

endmenu
endif

endmenu
endif
 

config BUILD_CHANNEL_QOS
	bool "Downlink rate control "
	default n
			select BUILD_IPROUTE2
			select BUILD_IPROUTE2_TC
	help
		Support Downlink rate control 
 
```

## Hybrid_GPL_63168/DT-W724V-20140311/package/atp/network/qos/KConfig.in
```kconfig
config QOS
	tristate "QOS"
	default y
config QOS_IPV6
	bool "Sure to support QOS for IPv6"
	default y
	depends on QOS
config IP_PREC_TOS_REMARK
	bool "Qos IPP Tos"
	default y
	depends on QOS
	
config NETFILTER_XT_MATCH_CONNLIMIT
	bool "QoS Connlimit control"
	default n
	depends on QOS	
	
config DOWN_RATE_CONTROL
	bool "Down rate control"
	default n
	depends on QOS	
	
config DT_QOS
	bool "DT Qos"
	default n
```

## Hybrid_GPL_63168/DT-W724V-20140311/package/atp/network/radvd/Config.in
```kconfig
config BUILD_RADVD
	bool "RADVD"
        default n
	help
	  Router Advertisement Daemon
	depends on BUILD_IPV6
	  
if BUILD_RADVD
menu "ATP Radvd Supported Selection"

config BUILD_IPV6_ULA
    bool "IPV6_ULA"
	    default n
    depends on BUILD_RADVD

config BUILD_RADVD_OPTION_RDNSS
    bool "IPV6 RA SUPPORT DNS"
	    default n
	 help
	  Router Advertisement Include dns
    depends on BUILD_RADVD
	
config BUILD_RADVD_ULA_PREFIX_FC
	bool "ULA support fc prefix  "
		default n
	depends on BUILD_RADVD
	help
	  Support ULA fc prefix
    
config BUILD_W724V_RA_CONFIG
    bool "DT W724v RA CONFIG"
	    default y
    depends on BUILD_RADVD
	
endmenu
endif
```

## Hybrid_GPL_63168/DT-W724V-20140311/package/atp/network/sntp/Config.in
```kconfig
config BUILD_SNTP
	bool "SNTP"
	help
	  Support Simple Network Time Protocol

if BUILD_SNTP
menu "ATP SNTP Supported Selection"

config BUILD_SNTP_DST
	bool "SNTP Daylight Saving Time"
	default y
	depends on BUILD_SNTP
	help
	  Select the Daylight Saving Time support

config BUILD_SNTP_SYNC_FAIL_NOTIFY
	bool "SNTP Sychronization failure notification"
	default n
	depends on BUILD_SNTP
	help
	  Select the SNTP Sychronization failure notification support

config BUILD_SNTP_START_WITH_WAN
	bool "SNTP Sychronization when WAN up"
	default n
	depends on BUILD_SNTP
	help
	  Select the SNTP Sychronization when WAN up 

config BUILD_SNTP_START_TIME_CUSTOMIZED
	bool "SNTP support customize start time"
	default n
	depends on BUILD_SNTP

if BUILD_SNTP_START_TIME_CUSTOMIZED
config SNTP_DEFAULT_START_TIME_STRING
	string "SNTP default start time string"
	default ""
	depends on BUILD_SNTP_START_TIME_CUSTOMIZED
endif

endmenu

endif
```

## Hybrid_GPL_63168/DT-W724V-20140311/package/atp/network/vlan/Config.in
```kconfig
config BUILD_BCM_VLAN
	bool "BCM VLAN"
	default y
	depends on BROADCOM_CHIP
	help
	  Support BCM VLANCTL
```

## Hybrid_GPL_63168/DT-W724V-20140311/package/atp/network/wan/Config.in
```kconfig
config BUILD_WANCMS
	bool "WAN management"
	default y
	select BUILD_WANVLAN
	help
	  Support WAN management

if BUILD_WANCMS
menu "ATP WANCMS Supported Selection"
config ATP_WAN_NUM_MAX
	int "MAX number of WAN connections"
	default "16"
	depends on BUILD_WANCMS
	
config BUILD_MTU
	bool "MTU config"
	default y
	depends on BUILD_WANCMS
	help
	  Support MTU config.
	  
config BUILD_TCP_MSS
	bool "TCP MSS"
	default y
	depends on BUILD_WANCMS
	help
	  Support MSS config.	  
	  
config BUILD_ENABLED_FOR_INTERNET
    bool "Enable for internet"
    depends on BUILD_WANCMS
    default n
 
config BUILD_DT_WAN_PAGE
    bool "DT wan page"
    depends on BUILD_WANCMS
    default n

config BUILD_WAN_HG532T_TELEFONICA_PERU_CUSTOMIZED
	bool "wan support telefonica peru customized"
	default n
    
config BUILD_IPV6_PPP_DIAL_ON_DEMAND
    bool "Support IPv6 dial on demand"
    depends on BUILD_WANCMS
    default n
    	
config BUILD_PPP_PASSTHROUGH
    bool "PPP passthrough"
    depends on BUILD_WANCMS
    default n
	
config BUILD_WAN_BACKUP
    bool "WAN Backup"
	default y
	depends on BUILD_WANCMS
	select BUILD_DNS_REDIRECT
	help
	  Support WAN backup.

config BUILD_WAN_AUTO_BACKUP
	bool "WAN Auto Backup"
	default n
	depends on BUILD_WANCMS && BUILD_WAN_BACKUP
	help
	  Support WAN Auto Backup

config BUILD_WAN_ADSL_PVC_NAME
    bool "Support ASDL WAN name as PVC:X/Y"
	default n
	depends on BUILD_WANCMS && BUILD_XDSL
	help
	  Support ASDL WAN name format is the same as PVC:X/Y.
	  
config BUILD_ROUTE_FORBID_DEFAULTROUTE_ON_OTHERWAN
    bool "OTHER wan don't add default route"
	default n
	depends on BUILD_WANCMS
	help
	  OTHER wan don't add default route in the bind policy route.
	  
config BUILD_WAN_NAT_TYPE_SEPARATE_FROM_ENABLE
    bool "Support Nat type seprate from enable"
	default n
	depends on BUILD_WANCMS
	help
	  Support Nat type seprate from enable.	  
	  
menu "Config WAN Customize Characteristics"
	depends on BUILD_WANCMS
config WANPPP_USERNAME_RULE_LIST
	string "WAN PPP Username Rule Supported(Comma-separated list without space)"
	default ""
	depends on BUILD_WANCMS
	
config WANPPP_USERNAME_SPECIAL_CHAR
	string "WAN PPP Username Spacial Char Supported"
	default ""
	depends on BUILD_WANCMS
	
config WANPPP_PASSWORD_RULE_LIST
	string "WAN PPP Password Rule Supported(Comma-separated list without space)"
	default ""
	depends on BUILD_WANCMS

config WANPPP_PASSWORD_SPECIAL_CHAR
	string "WAN PPP Password Spacial Char Supported"
	default ""
	depends on BUILD_WANCMS
	
config BUILD_WANPPP_NOT_NULL_STRING
	bool "Wan ppp username and password can not configure as null"
	default n
	depends on BUILD_WANCMS
	help
	  Support PPP Username and Password Without Null String
	  
config BUILD_MAC_CLONE
	bool "MAC address clone"
	default n
	depends on BUILD_WANCMS
	help
	  Support MAC address clone
endmenu 
endmenu
endif
```

## Hybrid_GPL_63168/DT-W724V-20140311/package/atp/voice/Config.in
```kconfig
menu "Voice Services"
	source "package/atp/voice/netpb/Config.in"
	source "package/atp/voice/rss/Config.in"
	source "package/atp/voice/email/Config.in"
	source "package/atp/voice/voiper/Config.in"
endmenu
```

## Hybrid_GPL_63168/DT-W724V-20140311/package/atp/voice/email/Config.in
```kconfig
config BUILD_FETCHEMAIL
	bool "Fetch Email"
	default n
	help
	  Support Fetch Email
```

## Hybrid_GPL_63168/DT-W724V-20140311/product/Config.in
```kconfig
menu "Product Config"

menu "Product Info" 
config BUILD_PRODUCT_NAME
	string "Product full name"
	default "HG2XX"
	help
	  Config custom product full name
	  
config BOARD_ID
	string  "Set Board Id"
	help
	  Set Board Id
	  eg:963268_hg257
		 963268_hg2xx
		 
config VOICE_BOARD_ID
	string  "Set Voice Board Id"
	help
	  Set Voice Board Id
	  eg:LE88536_THAL
		 LE9530_LE88276
endmenu		 
	 
source "product/version/Config.in"
source "product/flash/Config.in"
source "product/gpio/Config.in"
source "product/startup/Config.in"
source "product/image/Config.in"

endmenu 
```

## Hybrid_GPL_63168/DT-W724V-20140311/product/flash/Config.in
```kconfig
menu "Flash config"
  
choice
	prompt "Choose flash type"
	default BUILD_NANDFLASH

config BUILD_NORFLASH
	bool "support norflash"	
	help
	  Enable this option if you use norflash	
	
config BUILD_NANDFLASH
	bool "support nandflash"	
	help
	  Enable this option if you use nandflash

endchoice

config FLASH_NAND_FIRST_BLOCK_WITH_CFERAM
	bool "nand flash first block with cferam"
	depends on BUILD_NANDFLASH
	default n
	help
	  Set nand first block with cferam,bootloader with cfe_rom and cfe_ram.
	  
if FLASH_NAND_FIRST_BLOCK_WITH_CFERAM
	  
config FLASH_NAND_FIRST_BLOCK_WITH_CFERAM_BUILD_SCRIPT
	string "script to run before package images"
	default ""
	help
	  Specify a script to make sure that the sizeof bootloader is smaller 
	  than the block size.
	  
endif

config FLASH_NAND_BLOCK_SIZE
	int "nand flash block size"
	depends on BUILD_NANDFLASH
	default 16384
	help
	  Set nand flash block size,16384:16KB,131072:128KB.
	  
config FLASH_NAND_PAGE_SIZE
	int "nand flash page size"
	depends on BUILD_NANDFLASH
	default 512
	help
	  Set nand flash page size,small page：512byte,big page：2048byte.
	  
config FLASH_NAND_OOB_SIZE
	int "nand flash oob size"
	depends on BUILD_NANDFLASH
	default 16
	help
	  Set nand flash oob size,small page:16byte,big page:64byte.
	  
config BUILD_NANDFLASH_412
	bool "support nandflash_412"
	default y
	depends on BUILD_NANDFLASH
	help
	  Enable this option if you use nandflash_412

source "product/flash/FlashLayoutConfig.in"  

endmenu 
```
