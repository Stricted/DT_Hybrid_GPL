## Hybrid_GPL_63168/DT-W724V-20140311/package/atp/network/eth/Config.in
```kconfig
config BUILD_ETH
	bool "ETHERNET"
	default y
	help
	  Support ETHERNET

if BUILD_ETH
menu "ATP Ethernet Supported Selection"
config BUILD_ETH_BCM_EXT_SWITCH_53125
	bool "support BCM_EXT_SWITCH 53125"
	default y
	depends on BUILD_ETH
	help
	  support BCM_EXT_SWITCH 53125
	  
config BUILD_ETH_PORT_ORDER_REVERSED
	bool "Reversed eth port order"
	depends on BUILD_ETH
	help
	  different order as eth0.x. for example, port 1 is mapped to eth0.5, but port 4 is mapped to eth0.2

config BUILD_ETH_EXTERNALMODEM
	bool "Support W724v GE/DSL switch"
	depends on BUILD_TR181
	default n

config BUILD_LINK_MANUAL_SET
	bool "Support GE/DSL manual set"
	depends on BUILD_ETH_EXTERNALMODEM
	default n
	help
	  manual set wan link type to GE/DSL, need reboot to take effect

config BUILD_LINK_AUTOSENSE
	bool "Support GE/DSL autosense"
	depends on BUILD_ETH_EXTERNALMODEM
	default n

config BUILD_ETH_ONE_PORT
	bool "support eth one port"
	depends on BUILD_ETH
	default n	
	help
	  support eth one port

config BUILD_ETH_LANETH_CONTROL_DHCP_ON_LAN_PORT
	bool "Eth DHCP Lan Port Control"
	default n
	depends on BUILD_ETH
	help
	  support eth lan eth control dhcp on lan port
	  
source "package/atp/network/eth/service/ethcmd/Config.in"	  
source "package/atp/network/eth/service/ethswctl/Config.in"
source "package/atp/network/eth/wanethcms/Config.in"

endmenu
endif
```

## Hybrid_GPL_63168/DT-W724V-20140311/package/atp/network/firewall/KConfig.in
```kconfig
config FIREWALL
	tristate "FIREWALL"
	default y
config FIREWALL_LOG
	bool "Support Firewall log"
	default y
	depends on FIREWALL
```

## Hybrid_GPL_63168/DT-W724V-20140311/package/atp/network/fon/Config.in
```kconfig
config BUILD_FON
    bool "FON FOR DT W724V"
    default n
    help
      For FON support
```

## Hybrid_GPL_63168/DT-W724V-20140311/package/atp/network/hybrid/Config.in
```kconfig
config BUILD_HYBRID
	bool "Hybrid Access"
    default y
	help
	  hybrid access Service

if BUILD_HYBRID
menu "ATP HYBRID Supported Selection"
config BUILD_HYBRID_BONDING
	bool "Hybrid Bonding"
    default y
	select BUILD_NAT_CT_CLEAN
	help
	  hybrid bonding service
config BUILD_HYBRID_GREACCEL
	bool "Hybrid gre accel"
    default y
	help
	  hybrid gre accel	  
endmenu
endif
```

## Hybrid_GPL_63168/DT-W724V-20140311/package/atp/network/hybrid/KConfig.in
```kconfig
config ATP_HYBRID
	tristate "HYBRID"
	default y
config ATP_HYBRID_REORDER
	tristate "hybrid ReOrder"
	default y
	depends on ATP_HYBRID
config ATP_HYBRID_GREACCEL
	tristate "hybrid GRE acceleration"
	default y
	depends on ATP_HYBRID	
config ATP_CONNAT_ACCEL
	tristate "CONNAT acceleration"
	default y	
	depends on ATP_HYBRID	
config ATP_HYBRID_TUNNEL_IDLE
	tristate "hybrid GRE idle control"
	default y
	depends on ATP_HYBRID	
```

## Hybrid_GPL_63168/DT-W724V-20140311/package/atp/network/igmp/Config.in
```kconfig
config BUILD_IGMP
	bool "IGMP"
 	default y
	help
	  Internet Group Management Protocol

if BUILD_IGMP
menu "ATP IGMP Supported Selection"

choice
	prompt "Choose IGMP SNOOPING solution"
	default BUILD_BR_IGMP_SNOOP
	depends on BUILD_IGMP
	
	config BUILD_BR_IGMP_SNOOP
        bool "BROADCOM IGMP snoop"

	config BUILD_IGMP_SNOOPING
        bool "ATP IGMP snooping"

endchoice

config BUILD_IGMP_LOGCLI
        bool "IGMP log cli"
        default y
        depends on BUILD_IGMP

config BUILD_IGMP_V3
        bool "IGMP v3.0"
        default y
        depends on BUILD_IGMP
        
config BUILD_IGMP_PRI
    bool "IGMP priority"
    help
      Set igmp process priority
    default n
    depends on BUILD_IGMP
    
config ATP_IGMP_PRI
    int "IGMP value of priority"
    help
      Set value of priority
    default 5
    depends on BUILD_IGMP_PRI

config BUILD_IGMP_QUERY_QQIC
    bool "IGMP query time from qqic"
    help
      set igmp query from qqic
    default n
    depends on BUILD_IGMP
      
config BUILD_IGMP_SET_TOS
    bool "IGMP tos"
    help
      Set igmp tos
    default n
    depends on BUILD_IGMP

config BUILD_IGMP_SOURCE_LOG
    bool "IGMP source log"
    help
      Get igmp source log
    default n
    depends on BUILD_IGMP
    
config BUILD_IGMP_MULTI_CHECK
    bool "IGMP multi process check"
    help
      Check multi proces of igmp
    default n
    depends on BUILD_IGMP
    
config BUILD_IGMP_PRINT_PROXY_INFO
    bool "IGMP info "
    help
      Print igmp info
    default n
    depends on BUILD_IGMP
    
config BUILD_IGMP_QUERY_LEAVE
    bool "IGMP query for leave"
    help
      Sent query for leave
    default n
    depends on BUILD_IGMP
    
config ATP_IGMP_MAX_GROUP_NUMBER
    int "IGMP max groups number"
    help
      igmp max groups number
    default 32
    depends on BUILD_IGMP
	
config ATP_IGMP_MAX_MSF
    int "IGMP max source for v3"
    help
      igmp max source number
    default 10
    depends on BUILD_IGMP
    
config BUILD_IGMP_AUTO_SWITCH
    bool "IGMP auto swtich"
    help
      igmp chose the wan to run
    default n
    depends on BUILD_IGMP

config BUILD_DT_IGMP_AUTO_SWITCH
    bool "IGMP auto swtich for DT"
    help
      igmp chose the wan to run for DT
    default n
    depends on BUILD_IGMP_AUTO_SWITCH
    	
config BUILD_IGMP_ADVANCE_PARA
    bool "IGMP advance parameter"
    help
      igmp config parameter such as Robustness value
    default n
    depends on BUILD_IGMP
    
config BUILD_IGMP_PROXY_NOT_NEED_NAT
    bool "IGMP proxy not need nat"
    help
      igmp proxy needn't route wan must nat enable
    default n
    depends on BUILD_IGMP

config BUILD_IGMP_EXT_PARAMETERS_SET
    bool "igmp extern parameters set"
    help
      igmp extern parameters set
    default n
    depends on BUILD_IGMP	
	
config BUILD_IGMP_DT_FILTER
    bool "igmp filter enable"
    help
      igmp filter enable
    default n
    depends on BUILD_IGMP

config BUILD_IGMP_SSM
    bool "igmp ssm enable"
    help
      igmp ssm enable
    default y
    depends on BUILD_IGMP
    select IGMP_SSM
	
endmenu
endif
```

## Hybrid_GPL_63168/DT-W724V-20140311/package/atp/network/igmp/KConfig.in
```kconfig
config IGMP
	tristate "IGMP"
	default y
config IGMP_SNOOPING
	tristate "IGMP Snooping"
	default y
	depends on IGMP
config BR_IGMP_STATISTIC
	bool "IGMP support statistic"
	default n	
	depends on IGMP
config IGMP_ENG_DT
	bool "IGMP support DT ENG STAT"
	default n	
	depends on IGMP
config IGMP_SSM
	bool "IGMP support DT SSM requirement"
	default n	
	depends on IGMP
config IGMP_MAX_MSF
    int "IGMP max source for v3"
    help
      igmp max source number
    default 10
    depends on IGMP
config IGMP_MAX_GROUP_NUMBER
    int "IGMP max groups number"
    help
      igmp max groups number
    default 32
    depends on IGMP
config DT_IGMP_ENG
	bool "IGMP support DT ENG STAT"
	default n	
	depends on IGMP 
	depends on ATP_KERNEL_3_4
config DT_IGMP_QQIC
	bool "IGMP support DT QQIC"
	default n	
	depends on IGMP 
	depends on ATP_KERNEL_3_4
config ATP_IGMP_SSM
	bool "IGMP support SSM requirement"
	default n	
	depends on IGMP
	depends on ATP_KERNEL_3_4
config ATP_IGMP
	bool "ATP IGMP requirement"
	default n	
	depends on ATP_KERNEL_3_4
config ATP_IGMP_DROP_LEAVE_LAN2LAN
	bool "Drop IGMP leave packet from LAN to LAN"
	help
		Drop IGMP leave packet from LAN to LAN
	default n
	depends on IGMP
	depends on ATP_KERNEL_3_4
config ATP_IGMP_CONTROL_REPORT_NUM
	bool "Control report number by proc for igmp v3"
	help
		Control report number by proc for igmp v3
	default n
	depends on IGMP
	depends on ATP_KERNEL_3_4
```

## Hybrid_GPL_63168/DT-W724V-20140311/package/atp/network/mld/KConfig.in
```kconfig
config MLD
	tristate "MLD"
	default y
config MLD_SNOOPING
	tristate "MLD Snooping"
	default y
	depends on MLD
config ATP_MLD_SNOOPING
	tristate "ATP MLD Snooping"
	default y
	depends on MLD
	depends on ATP_KERNEL_3_4
```

## Hybrid_GPL_63168/DT-W724V-20140311/package/atp/network/nat/Config.in
```kconfig
config BUILD_NAT
	bool "NAT"
	default y
	help
	  Support NAT basic function

if BUILD_NAT
menu "ATP NAT Supported Selection"

config BUILD_ALLCONENAT
	bool "ALLCONENAT"
	depends on BUILD_NAT
	help 
	  Support all cone nat function

config BUILD_CONENAT
	bool "CONENAT"
	depends on BUILD_NAT
	help 
	  Support cone nat function

config BUILD_PORTTRIGGER
	bool "PORTTRIGGER"
	depends on BUILD_NAT
	help 
	  Support porttrigger function	  

if BUILD_PORTTRIGGER
menu "ATP Port Trigger Supported Selection"

config BUILD_NAT_PORT_TRG_RANGE
    bool "NAT port trigger range"
    help
      nat port trigger range
    default n
    depends on BUILD_PORTTRIGGER

endmenu
endif

config BUILD_PORTMAPPING
    bool "PORTMAPPING & DMZ"
    help
      Support port mapping
    default y
    depends on BUILD_NAT

config BUILD_MULTI_INTERNAL_PORTMAPPING
	bool "Portmapping with multi-internal-port support"
	help
	  Support portmapping with multi-internal-port
	default n
	depends on BUILD_NAT && BUILD_PORTMAPPING

config BUILD_NAT_HOST_PORT_MAP
    bool "NAT host port mapping"
    help
      nat host port mapping
    default n
    depends on BUILD_NAT
  
config BUILD_PORTMAPPING_APPLICATION
	bool "Support portmapping application"
	default n
	depends on BUILD_PORTMAPPING
	help
	  Support portmapping application management.
	  
config BUILD_NAT_PORTMAPPING_RULES_WITH_SAMENAME
	bool "Support one portmapping name have more rules"
	default n
	depends on BUILD_PORTMAPPING && MTK_CHIP
	help
	  Support one portmapping name have more rules.
	  
config BUILD_MULTINAT
	bool "MULTINAT"
	depends on BUILD_NAT
	help 
	  Support multiplenat function	
	  
source "package/atp/network/nat/cms/Config.in"
endmenu
endif
```

## Hybrid_GPL_63168/DT-W724V-20140311/package/atp/network/pppc/Config.in
```kconfig
config BUILD_PPPC
	bool "PPPC"
	default dynamic
	help
	  Support  pppc.

if BUILD_PPPC
menu "ATP PPPC Supported Selection"

config BUILD_PPPoA
	bool "PPPoA"
	default dynamic
	depends on BUILD_PPPC
	help
		Support pppoa.
		
config BUILD_PPPoS
	bool "PPPoS"
	default dynamic
	depends on BUILD_PPPC
	help
		Support pppos.
		
config BUILD_PPPC6
	bool "PPPC6"
	default dynamic
	depends on BUILD_IPV6 && BUILD_PPPC
	help
		Support pppc6.
		
config BUILD_PPP_STATICIP
	bool "PPP_STATICIP"
	default dynamic
	depends on BUILD_PPPC
	help
		Support static ip request.
			
		
config BUILD_PPP_ISP
	bool "PPP_ISP"
	default dynamic
	depends on BUILD_PPPC
	help
		Support if it is ISP or not .
		
config BUILD_PPP_DEFAULTUSER
	bool "PPP_DEFAULTUSER"
	default dynamic
	depends on BUILD_PPPC
	help
		Support if it is a default user or not.
config BUILD_PPP_TRIGGERDEMAND
	bool "PPP_TRIGGERDEMAND"
	default dynamic
	depends on BUILD_PPPC
	help
		Support if trigger dial when process come up.		
		
config BUILD_PPP_DEMAND_RCVPACKET
	bool "PPP_DEMAND_RCVPACKET"
	default dynamic
	depends on BUILD_PPPC
	help
		Support if receive packet trigger demand mode	
		
config BUILD_PPP_TAG_MACUNIQ
	bool "PPP_TAG_MACUNIQ"
	default dynamic
	depends on BUILD_PPPC
	help
		Support if host uniq tag set with local mac	
		
config BUILD_PPP_LOG_BT_HHUB3
	bool "PPP_LOG_BT_HHUB3"
	default dynamic
	depends on BUILD_PPPC
	help
		Support BT log.			

config BUILD_PPP_REDISCON_BT_HHUB3
	bool "PPP_REDISCON_BT_HHUB3"
	default dynamic
	depends on BUILD_PPPC
	help
		Support when disconnet link,it will send 5 PADT to BRAS.

config BUILD_PPP_PLUGDSL_CRASH_BT_HHUB3
	bool "PPP_PLUGDSL_CRASH_BT_HHUB3"
	default n
	depends on BUILD_PPPC
	help
		Fix the BT issue of pluging  and unpluging  dsl line cause the system crash .
config BUILD_PPP_TOGGLE_DT_W723V
	bool "PPP_TOGGLE_DT_W723V"
	default y
	depends on BUILD_PPPC
	help
		Support toggle vlan 0 and vlan 7 for DT pppc .
config BUILD_PPP_DYN_DIAL
	bool "PPP V4 V6 dynamic dial, for W724V, see TOCPE0056.pdf"
	default n
	depends on BUILD_PPPC
	help
		Support DT W724V .
		
config BUILD_PPP_IGMP_DIAL
	bool "support DT W724v IGMP traffic"
	depends on BUILD_PPPC
	default n
	
config BUILD_PPP_DT_TOCPE0056
	bool "Support DT W724V TOCPE0056.pdf"
	default n
	depends on SUPPORT_ATP_PPP_DYN_DIAL
	help
		Support DT W724V TOCPE0056.pdf.

config BUILD_PPP_ON_DEMAND_ALL_IN_ONE_BRIDGE
	bool "PPP more than one V4 dial on demand in one bridge"
	default n
	depends on BUILD_PPPC
	help
		Support more than one V4 dial on demand in one bridge.
				
config BUILD_PPP_RALINK_ATM
	bool "PPP_RALINK_ATM"
	default n
	depends on BUILD_PPPC && MTK_CHIP
	help
		Support TC3162U and RT63365 .
		
endmenu
endif
```

## Hybrid_GPL_63168/DT-W724V-20140311/package/atp/network/pppc/KConfig.in
```kconfig
config DT_PPP_DYN_DIAL
	bool "support DT W724v PPP dynamic dial"
	default y
config ATP_PPP_NAT_GATE
	bool "support ppp don't forward packet before NAT opened"
	default y
	depends on ATP_KERNEL_3_4
config ATP_PPP_FAST_DIAL
	bool "support ppp fast dial"
	default y
	depends on ATP_KERNEL_3_4
	help
		see DTS2012090605186 or AU8D04132 for more detail
```
